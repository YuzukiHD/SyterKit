## lib/Kconfig
```kconfig
# SPDX-License-Identifier: GPL-2.0+

menu "Library routines"

source "lib/fatfs/Kconfig"

endmenu
```

## lib/fatfs/Kconfig
```kconfig
# SPDX-License-Identifier: GPL-2.0+

config FATFS_CACHE
	bool "Enable the FatFs cache"

if FATFS_CACHE

config FATFS_CACHE_SIZE
	hex
	default 0x02000000 if BOARD_AVAOTA_86BOX || BOARD_TLT153_MINIEVM || BOARD_YUZUKIHOMEKIT
	default 0x0fffffff if BOARD_AVAOTA_A1 || BOARD_AVAOTA_M1 || BOARD_MCORE_R818 || BOARD_RADXA_CUBIE_A7A
	default 0x00ffffff if BOARD_AVAOTA_F1 || BOARD_AVAOTA_F2

config FATFS_CACHE_ADDR
	hex
	default 0x48000000 if BOARD_AVAOTA_86BOX || BOARD_TLT153_MINIEVM || BOARD_YUZUKIHOMEKIT
	default 0x04400000 if BOARD_AVAOTA_A1 || BOARD_MCORE_R818
	default 0x82000000 if BOARD_AVAOTA_F1
	default 0x42000000 if BOARD_AVAOTA_F2
	default 0x44000000 if BOARD_AVAOTA_M1
	default 0x60000000 if BOARD_RADXA_CUBIE_A7A

endif
```

## soc/Kconfig
```kconfig
# SPDX-License-Identifier: GPL-2.0+

menu "SoC eFEX applications"
	depends on EFEX

choice
	prompt "Target SoC"

source "$(SOC_KCONFIG_LIST)"

endchoice

config SYS_SOC
	string
	default "sun252iw1" if EFEX_SOC_SUN252IW1
	default "sun252iw2" if EFEX_SOC_SUN252IW2
	default "sun300iw1" if EFEX_SOC_SUN300IW1
	default "sun50iw9" if EFEX_SOC_SUN50IW9
	default "sun55iw3" if EFEX_SOC_SUN55IW3
	default "sun55iw6" if EFEX_SOC_SUN55IW6
	default "sun60iw2" if EFEX_SOC_SUN60IW2
	default "sun65iw1" if EFEX_SOC_SUN65IW1
	default "sun8iw21" if EFEX_SOC_SUN8IW21
	default "sun8iw22" if EFEX_SOC_SUN8IW22

choice
	prompt "sun60iw2 DRAM type"
	depends on EFEX_SOC_SUN60IW2
	default EFEX_DRAM_LPDDR5

config EFEX_DRAM_LPDDR4
	bool "LPDDR4"

config EFEX_DRAM_LPDDR5
	bool "LPDDR5"

endchoice

endmenu
```

## soc/sun252iw1/Kconfig
```kconfig
# SPDX-License-Identifier: GPL-2.0+

config EFEX_SOC_SUN252IW1
	bool "sun252iw1"
	depends on ARCH_RISCV32 && (ARCH_CPU_E907 || ARCH_CPU_C907)
	select SOC_SUN252IW1
```

## soc/sun300iw1/Kconfig
```kconfig
# SPDX-License-Identifier: GPL-2.0+

config EFEX_SOC_SUN300IW1
	bool "sun300iw1"
	depends on ARCH_RISCV32 && ARCH_CPU_E907
	select SOC_SUN300IW1
```

## soc/sun300iw1/configs/efex_defconfig
```kconfig
# SPDX-License-Identifier: GPL-2.0+
CONFIG_BUILD_RELEASE=y
CONFIG_OPTIMIZE_FOR_SIZE=y
CONFIG_EFEX=y
CONFIG_ARCH_RISCV32=y
CONFIG_ARCH_CPU_E907=y
CONFIG_BACKTRACE_MIN=y
CONFIG_SPL_FEL_TEXT_BASE=0x02000000
CONFIG_SPL_FEL_MAX_SIZE=0x00020000
CONFIG_DRIVER_CLK=y
CONFIG_DRIVER_GPIO_V2=y
CONFIG_DRIVER_DRAM=y
CONFIG_DRIVER_SERIAL=y
CONFIG_EFEX_SOC_SUN300IW1=y
```

## soc/sun50iw9/Kconfig
```kconfig
# SPDX-License-Identifier: GPL-2.0+

config EFEX_SOC_SUN50IW9
	bool "sun50iw9"
	depends on ARCH_ARM32 && CPU_ARMV8
	select SOC_SUN50IW9
```

## soc/sun50iw9/configs/efex_defconfig
```kconfig
# SPDX-License-Identifier: GPL-2.0+
CONFIG_BUILD_RELEASE=y
CONFIG_OPTIMIZE_FOR_SIZE=y
CONFIG_EFEX=y
CONFIG_ARCH_ARM32=y
CONFIG_CPU_ARMV8=y
CONFIG_BACKTRACE_MIN=y
CONFIG_ARCH_ICACHE=y
CONFIG_SPL_FEL_TEXT_BASE=0x00028000
CONFIG_SPL_FEL_MAX_SIZE=0x00020000
CONFIG_DRIVER_CLK=y
CONFIG_DRIVER_GPIO_V1=y
CONFIG_DRIVER_I2C=y
CONFIG_DRIVER_PMIC_AXP=y
CONFIG_DRIVER_DRAM=y
CONFIG_DRIVER_RTC=y
CONFIG_DRIVER_SERIAL=y
CONFIG_DRIVER_SID=y
CONFIG_EFEX_SOC_SUN50IW9=y
```

## soc/sun55iw3/Kconfig
```kconfig
# SPDX-License-Identifier: GPL-2.0+

config EFEX_SOC_SUN55IW3
	bool "sun55iw3"
	depends on ARCH_ARM32 && CPU_ARMV8_2
	select SOC_SUN55IW3
```

## soc/sun55iw3/configs/efex_defconfig
```kconfig
# SPDX-License-Identifier: GPL-2.0+
CONFIG_BUILD_RELEASE=y
CONFIG_OPTIMIZE_FOR_SIZE=y
CONFIG_EFEX=y
CONFIG_ARCH_ARM32=y
CONFIG_CPU_ARMV8_2=y
CONFIG_BACKTRACE_MIN=y
CONFIG_ARCH_DCACHE=y
CONFIG_ARCH_ICACHE=y
CONFIG_SPL_FEL_TEXT_BASE=0x00020000
CONFIG_SPL_FEL_MAX_SIZE=0x00020000
CONFIG_DRIVER_CLK=y
CONFIG_DRIVER_GPIO_V2_POW=y
CONFIG_DRIVER_I2C=y
CONFIG_DRIVER_PMIC_AXP=y
CONFIG_DRIVER_DRAM=y
CONFIG_DRIVER_REMOTEPROC=y
CONFIG_DRIVER_SERIAL=y
CONFIG_CLI_HEAP_STORAGE=y
CONFIG_FATFS_LFN_HEAP=y
CONFIG_EFEX_SOC_SUN55IW3=y
```

## soc/sun55iw6/Kconfig
```kconfig
# SPDX-License-Identifier: GPL-2.0+

config EFEX_SOC_SUN55IW6
	bool "sun55iw6"
	depends on ARCH_ARM32 && CPU_ARMV8_2
	select SOC_SUN55IW6
```

## soc/sun55iw6/configs/efex_defconfig
```kconfig
# SPDX-License-Identifier: GPL-2.0+
CONFIG_BUILD_RELEASE=y
CONFIG_OPTIMIZE_FOR_SIZE=y
CONFIG_EFEX=y
CONFIG_ARCH_ARM32=y
CONFIG_CPU_ARMV8_2=y
CONFIG_BACKTRACE_MIN=y
CONFIG_ARCH_DCACHE=y
CONFIG_ARCH_ICACHE=y
CONFIG_SPL_FEL_TEXT_BASE=0x0004c000
CONFIG_SPL_FEL_MAX_SIZE=0x00018000
CONFIG_DRIVER_GPIO_V3=y
CONFIG_DRIVER_SERIAL=y
CONFIG_EFEX_SOC_SUN55IW6=y
```

## soc/sun60iw2/Kconfig
```kconfig
# SPDX-License-Identifier: GPL-2.0+

config EFEX_SOC_SUN60IW2
	bool "sun60iw2"
	depends on ARCH_ARM32 && CPU_ARMV8_2
	select SOC_SUN60IW2
```

## soc/sun60iw2/configs/lpddr5_efex_defconfig
```kconfig
# SPDX-License-Identifier: GPL-2.0+
CONFIG_BUILD_RELEASE=y
CONFIG_OPTIMIZE_FOR_SIZE=y
CONFIG_EFEX=y
CONFIG_ARCH_ARM32=y
CONFIG_CPU_ARMV8_2=y
CONFIG_BACKTRACE_MIN=y
CONFIG_ARCH_DCACHE=y
CONFIG_ARCH_ICACHE=y
CONFIG_SPL_FEL_TEXT_BASE=0x00048c00
CONFIG_SPL_FEL_MAX_SIZE=0x00040000
CONFIG_DRIVER_CLK=y
CONFIG_DRIVER_GPIO_V3=y
CONFIG_DRIVER_I2C=y
CONFIG_DRIVER_PMIC_AXP=y
CONFIG_DRIVER_DRAM=y
CONFIG_DRIVER_SERIAL=y
CONFIG_EFEX_SOC_SUN60IW2=y
CONFIG_EFEX_DRAM_LPDDR5=y
```

## soc/sun65iw1/Kconfig
```kconfig
# SPDX-License-Identifier: GPL-2.0+

config EFEX_SOC_SUN65IW1
	bool "sun65iw1"
	depends on ARCH_ARM32 && CPU_ARMV8
	select SOC_SUN65IW1
```

## soc/sun65iw1/configs/efex_defconfig
```kconfig
# SPDX-License-Identifier: GPL-2.0+
CONFIG_BUILD_RELEASE=y
CONFIG_OPTIMIZE_FOR_SIZE=y
CONFIG_EFEX=y
CONFIG_ARCH_ARM32=y
CONFIG_CPU_ARMV8=y
CONFIG_BACKTRACE_MIN=y
CONFIG_ARCH_DCACHE=y
CONFIG_ARCH_ICACHE=y
CONFIG_SPL_FEL_TEXT_BASE=0x0004c000
CONFIG_SPL_FEL_MAX_SIZE=0x00023000
CONFIG_DRIVER_CLK=y
CONFIG_DRIVER_GPIO_V4=y
CONFIG_DRIVER_I2C=y
CONFIG_DRIVER_PMIC_AXP=y
CONFIG_DRIVER_DRAM=y
CONFIG_DRIVER_SERIAL=y
CONFIG_DRIVER_SID=y
CONFIG_EFEX_SOC_SUN65IW1=y
```

## soc/sun8iw21/Kconfig
```kconfig
# SPDX-License-Identifier: GPL-2.0+

config EFEX_SOC_SUN8IW21
	bool "sun8iw21"
	depends on ARCH_ARM32 && CPU_CORTEX_A7
	select SOC_SUN8IW21
```

## soc/sun8iw22/Kconfig
```kconfig
# SPDX-License-Identifier: GPL-2.0+

config EFEX_SOC_SUN8IW22
	bool "sun8iw22"
	depends on ARCH_ARM32 && CPU_CORTEX_A7
	select SOC_SUN8IW22
```
