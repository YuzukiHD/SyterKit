## Kconfig
```kconfig
# SPDX-License-Identifier: GPL-2.0+

mainmenu "SyterKit Configuration"

source "arch/Kconfig"
source "drivers/Kconfig"
source "core/Kconfig"
source "lib/Kconfig"

choice
	prompt "Application runtime mode"
	default APP_SRAM

config APP_SRAM
	bool "SRAM application"

config EFEX
	bool "Returning eFEX application"
	depends on !ARCH_RISCV64

config APP_DRAM
	bool "DRAM application"

endchoice

source "boards/Kconfig"
source "soc/Kconfig"

menu "Image layout"

config SPL_BIN_TEXT_BASE
	hex "Binary image load address"
	depends on APP_SRAM

config SPL_BIN_MAX_SIZE
	hex "Binary image maximum size"
	depends on APP_SRAM

config SPL_FEL_TEXT_BASE
	hex "FEL image load address"

config SPL_FEL_MAX_SIZE
	hex "FEL image maximum size"

config APP_DRAM_TEXT_BASE
	hex "DRAM application load address"
	depends on APP_DRAM
	default 0x82000000 if BOARD_AVAOTA_F1
	default 0x42000000

config APP_DRAM_MAX_SIZE
	hex "DRAM application maximum size"
	depends on APP_DRAM
	default 0x01000000

endmenu

menu "Build options"

choice
	prompt "Build mode"
	optional

config BUILD_RELEASE
	bool "Release"

config BUILD_DEBUG
	bool "Debug"

config BUILD_TRACE
	bool "Trace"

endchoice

config OPTIMIZE_FOR_SIZE
	bool "Optimize for size"

config RUST_FFI
	bool "Build Rust FFI and applications"
	depends on DRIVER_SERIAL
	help
	  Build the no_std Rust FFI, driver, core, and library crates. Bindings are generated
	  by bindgen from rust/ffi/headers.txt; board-declared Rust applications are
	  linked into the selected image. The feature is optional so normal C-only
	  builds do not require Rust or libclang.

endmenu
```

## arch/Kconfig
```kconfig
# SPDX-License-Identifier: GPL-2.0+

menu "Architecture"

config ARCH_ARM
	bool

config ARCH_RISCV
	bool

choice
	prompt "Architecture"
	optional

config ARCH_ARM32
	select ARCH_ARM
	bool "ARM 32-bit"

config ARCH_RISCV32
	select ARCH_RISCV
	bool "RISC-V 32-bit"

config ARCH_RISCV64
	select ARCH_RISCV
	bool "RISC-V 64-bit"

endchoice

source "arch/arm/Kconfig"
source "arch/riscv/Kconfig"

config ARCH_DCACHE
	bool "Enable the data cache"

config ARCH_ICACHE
	bool "Enable the instruction cache"

config BACKTRACE
	bool

choice
	prompt "Backtrace implementation"
	optional

config BACKTRACE_MIN
	bool "Minimal address-only backtrace"
	select BACKTRACE
	help
	  Print raw return addresses with the smallest runtime and image-size
	  overhead.

config BACKTRACE_FULL
	bool "Full symbolized backtrace"
	select BACKTRACE
	help
	  Generate a symbol table for each output ELF and print function names,
	  offsets, and sizes in the call trace.

endchoice

config ARCH_EXCEPTION
	bool "Enable exception handling"
	depends on ARCH_ARM || ARCH_RISCV
	default y
	help
	  Install the architecture trap entry and dispatch interrupts through the
	  configured interrupt controller.  Other traps halt the system.

source "arch/Kconfig.soc"

source "arch/Kconfig.boot"

endmenu
```

## arch/Kconfig.soc
```kconfig
# SPDX-License-Identifier: GPL-2.0+

config SOC_SUN20IW1
	bool

config SOC_SUN252IW1
	bool

config SOC_SUN300IW1
	bool

config SOC_SUN50IW9
	bool

config SOC_SUN50IW10
	bool

config SOC_SUN55IW3
	bool

config SOC_SUN55IW6
	bool

config SOC_SUN60IW2
	bool

config SOC_SUN65IW1
	bool

config SOC_SUN8IW20
	bool

config SOC_SUN8IW21
	bool

config SOC_SUN8IW22
	bool
```

## arch/arm/Kconfig
```kconfig
# SPDX-License-Identifier: GPL-2.0+

choice
	prompt "ARM processor core"
	depends on ARCH_ARM32
	optional

config CPU_CORTEX_A7
	bool "Cortex-A7"

config CPU_ARMV8
	bool "ARMv8-A"

config CPU_ARMV8_2
	bool "ARMv8.2-A"

endchoice

config ARM_HARDFP
	bool "Use the hard-float ABI"
	depends on CPU_CORTEX_A7
```

## arch/riscv/cpu/Kconfig
```kconfig
# SPDX-License-Identifier: GPL-2.0+

choice
	prompt "RISC-V processor core"
	depends on ARCH_RISCV
	optional

config ARCH_CPU_E907
	bool "Xuantie E907"
	depends on ARCH_RISCV32

config ARCH_CPU_C907
	bool "Xuantie C907"
	depends on ARCH_RISCV32 || ARCH_RISCV64

config ARCH_CPU_C906
	bool "Xuantie C906"
	depends on ARCH_RISCV64

endchoice

config ARCH_MTVT
	bool "Enable the mtvt vector-table base register"
	depends on ARCH_RISCV
	help
	  Program the Xuantie mtvt CSR (0x307) with the interrupt vector-table base.

config ARCH_EXTRA_CFLAG
	string
	default "-mcpu=e907f" if ARCH_CPU_E907
	default "-mtune=c907" if ARCH_CPU_C907
	default "-mtune=c906" if ARCH_CPU_C906

config ARCH_RISCV64_ABI_LP64
	bool "Use the integer-only LP64 ABI"
	depends on ARCH_RISCV64 && ARCH_CPU_C907
	help
	  Build C907 RV64 firmware with the soft-float LP64 calling convention.
	  Enable this when linking vendor objects that use the LP64 ABI rather
	  than LP64D.
```

## archive/boards/100ask-d1-h/Kconfig
```kconfig
# SPDX-License-Identifier: GPL-2.0+

config BOARD_100ASK_D1_H
	bool "100ASK D1-H"
	depends on ARCH_RISCV64 && ARCH_CPU_C906
	select SOC_SUN20IW1
```

## archive/boards/100ask-t113s3/Kconfig
```kconfig
# SPDX-License-Identifier: GPL-2.0+

config BOARD_100ASK_T113S3
	bool "100ASK T113-S3"
	depends on ARCH_ARM32 && CPU_CORTEX_A7
	select SOC_SUN8IW20
```

## archive/boards/avaota-86box/Kconfig
```kconfig
# SPDX-License-Identifier: GPL-2.0+

config BOARD_AVAOTA_86BOX
	bool "Avaota 86Box"
	depends on ARCH_ARM32 && CPU_CORTEX_A7
	select SOC_SUN8IW20
```

## archive/boards/dongshanpi-aict/Kconfig
```kconfig
# SPDX-License-Identifier: GPL-2.0+

config BOARD_DONGSHANPI_AICT
	bool "DongshanPI AICT"
	depends on ARCH_ARM32 && CPU_CORTEX_A7
	select SOC_SUN8IW21
```

## archive/boards/mcore-r818/Kconfig
```kconfig
# SPDX-License-Identifier: GPL-2.0+

config BOARD_MCORE_R818
	bool "MCore R818"
	depends on ARCH_ARM32 && CPU_ARMV8
	select SOC_SUN50IW10
```

## archive/boards/project-yosemite/Kconfig
```kconfig
# SPDX-License-Identifier: GPL-2.0+

config BOARD_PROJECT_YOSEMITE
	bool "Project Yosemite"
	depends on ARCH_ARM32 && CPU_CORTEX_A7
	select SOC_SUN8IW21
```

## archive/boards/yuzukihomekit/Kconfig
```kconfig
# SPDX-License-Identifier: GPL-2.0+

config BOARD_YUZUKIHOMEKIT
	bool "Yuzuki HomeKit"
	depends on ARCH_ARM32 && CPU_CORTEX_A7
	select SOC_SUN8IW20
```

## boards/100ask-t113i/Kconfig
```kconfig
# SPDX-License-Identifier: GPL-2.0+

config BOARD_100ASK_T113I
	bool "100ASK T113-I"
	depends on ARCH_ARM32 && CPU_CORTEX_A7
	select SOC_SUN8IW20
```

## boards/Kconfig
```kconfig
# SPDX-License-Identifier: GPL-2.0+

menu "Board selection"
	depends on APP_SRAM || APP_DRAM

choice
	prompt "Target board"
	optional

source "$(BOARD_KCONFIG_LIST)"

endchoice

config SYS_BOARD
	string "Board source directory"

endmenu
```

## boards/avaota-a1/Kconfig
```kconfig
# SPDX-License-Identifier: GPL-2.0+

config BOARD_AVAOTA_A1
	bool "Avaota A1"
	depends on ARCH_ARM32 && CPU_ARMV8_2
	select SOC_SUN55IW3
```

## boards/avaota-f1/Kconfig
```kconfig
# SPDX-License-Identifier: GPL-2.0+

config BOARD_AVAOTA_F1
	bool "Avaota F1"
	depends on ARCH_RISCV32 && ARCH_RISCV32_CORE_E907
	select SOC_SUN300IW1
```

## boards/avaota-f1/configs/sram_defconfig
```kconfig
# SPDX-License-Identifier: GPL-2.0+
CONFIG_BUILD_RELEASE=y
CONFIG_OPTIMIZE_FOR_SIZE=y
CONFIG_APP_SRAM=y
CONFIG_ARCH_RISCV32=y
CONFIG_ARCH_CPU_E907=y
CONFIG_ARCH_MTVT=y
CONFIG_BACKTRACE_MIN=y
CONFIG_SYS_BOARD="avaota-f1"
CONFIG_SPL_BIN_TEXT_BASE=0x02000000
CONFIG_SPL_BIN_MAX_SIZE=0x00020000
CONFIG_SPL_FEL_TEXT_BASE=0x02000000
CONFIG_SPL_FEL_MAX_SIZE=0x00020000
CONFIG_DRIVER_CLK=y
CONFIG_DRIVER_CLIC=y
CONFIG_DRIVER_DMA=y
CONFIG_DRIVER_GPIO_V2=y
CONFIG_DRIVER_I2C=y
CONFIG_DRIVER_MMC=y
CONFIG_DRIVER_MTD=y
CONFIG_DRIVER_MTD_SPI_NOR=y
CONFIG_DRIVER_PWM=y
CONFIG_DRIVER_DRAM=y
CONFIG_DRIVER_REMOTEPROC=y
CONFIG_DRIVER_RTC=y
CONFIG_DRIVER_SERIAL=y
CONFIG_DRIVER_SID=y
CONFIG_DRIVER_SPI=y
CONFIG_FATFS_CACHE=y
CONFIG_BOARD_AVAOTA_F1=y
```

## boards/avaota-f2/Kconfig
```kconfig
# SPDX-License-Identifier: GPL-2.0+

config BOARD_AVAOTA_F2
	bool "Avaota F2"
	depends on ARCH_CPU_E907 || ARCH_CPU_C907
	select SOC_SUN252IW1
```

## boards/avaota-m1/Kconfig
```kconfig
# SPDX-License-Identifier: GPL-2.0+

config BOARD_AVAOTA_M1
	bool "Avaota M1"
	depends on ARCH_ARM32 && CPU_ARMV8
	select SOC_SUN65IW1
```

## boards/longanpi-3h/Kconfig
```kconfig
# SPDX-License-Identifier: GPL-2.0+

config BOARD_LONGANPI_3H
	bool "LonganPi 3H"
	depends on ARCH_ARM32 && CPU_ARMV8
	select SOC_SUN50IW9
```

## boards/radxa-cubie-a7a/Kconfig
```kconfig
# SPDX-License-Identifier: GPL-2.0+

config BOARD_RADXA_CUBIE_A7A
	bool "Radxa Cubie A7A"
	depends on ARCH_ARM32 && CPU_ARMV8_2
	select SOC_SUN60IW2
```

## boards/radxa-cubie-a7z/Kconfig
```kconfig
# SPDX-License-Identifier: GPL-2.0+

config BOARD_RADXA_CUBIE_A7Z
	bool "Radxa Cubie A7Z"
	depends on ARCH_ARM32 && CPU_ARMV8_2
	select SOC_SUN60IW2
```

## boards/tinyvision/Kconfig
```kconfig
# SPDX-License-Identifier: GPL-2.0+

config BOARD_TINYVISION
	bool "TinyVision"
	depends on ARCH_ARM32 && CPU_CORTEX_A7
	select SOC_SUN8IW21
```

## boards/tlt153-minievm/Kconfig
```kconfig
# SPDX-License-Identifier: GPL-2.0+

config BOARD_TLT153_MINIEVM
	bool "TLT153 MiniEVM"
	depends on ARCH_ARM32 && CPU_CORTEX_A7
	select SOC_SUN8IW22
```
