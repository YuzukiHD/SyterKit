## boards/tlt536-evm/Kconfig
```kconfig
# SPDX-License-Identifier: GPL-2.0+

config BOARD_TLT536_EVM
	bool "TLT536 EVM"
	depends on ARCH_ARM32 && CPU_ARMV8_2
	select SOC_SUN55IW6
```

## boards/yuzuki-cardsight/Kconfig
```kconfig
# SPDX-License-Identifier: MIT

config BOARD_YUZUKI_CARDSIGHT
	bool "Yuzuki CardSight"
	depends on ARCH_CPU_E907 || ARCH_CPU_C907
	select SOC_SUN252IW1
```

## boards/yuzuki-cardsight/configs/efex_defconfig
```kconfig
# SPDX-License-Identifier: MIT
CONFIG_BUILD_RELEASE=y
CONFIG_OPTIMIZE_FOR_SIZE=y
CONFIG_EFEX=y
CONFIG_ARCH_RISCV32=y
CONFIG_ARCH_CPU_E907=y
CONFIG_BACKTRACE_MIN=y
CONFIG_SYS_BOARD="yuzuki-cardsight"
CONFIG_SPL_FEL_TEXT_BASE=0x00100000
CONFIG_SPL_FEL_MAX_SIZE=0x00020000
CONFIG_DRIVER_CLK=y
CONFIG_DRIVER_GPIO_V2=y
CONFIG_DRIVER_PSRAM=y
CONFIG_DRIVER_SERIAL=y
CONFIG_BOARD_YUZUKI_CARDSIGHT=y
```

## boards/yuzukilizard/Kconfig
```kconfig
# SPDX-License-Identifier: GPL-2.0+

config BOARD_YUZUKILIZARD
	bool "Yuzuki Lizard"
	depends on ARCH_ARM32 && CPU_CORTEX_A7
	select SOC_SUN8IW21
```

## boards/yuzukineko/Kconfig
```kconfig
# SPDX-License-Identifier: GPL-2.0+

config BOARD_YUZUKINEKO
	bool "Yuzuki Neko"
	depends on ARCH_CPU_C907
	select SOC_SUN252IW2
	select DRIVER_SPIF
	select DRIVER_SPIF_V2
```

## components/Kconfig
```kconfig
# SPDX-License-Identifier: GPL-2.0+

menu "Components"

source "components/coremark/Kconfig"

endmenu
```

## components/coremark/Kconfig
```kconfig
# SPDX-License-Identifier: GPL-2.0+

config COMPONENT_COREMARK
	bool "CoreMark benchmark (EEMBC)"
	help
	  Build the unmodified CoreMark sources with a SyterKit port
	  (components/coremark/syterkit). An application calls
	  coremark_main() after the console is up.

config COREMARK_THREADS
	int "Harts that run CoreMark in parallel"
	depends on COMPONENT_COREMARK
	range 1 2
	default 1
	help
	  1 runs the benchmark on the boot hart. 2 runs one copy per hart and
	  needs ARCH_SMP; the score is the sum of both harts.

config COREMARK_ITERATIONS
	int "Iterations (0 = pick so that the run lasts 10 to 100 seconds)"
	depends on COMPONENT_COREMARK
	default 0

config COREMARK_CPU_MV
	int "CPU core voltage in mV (AXP333 dcdc1), set before the CPU PLL is raised; 0 leaves it alone"
	depends on COMPONENT_COREMARK
	default 0

config COREMARK_CPU_MHZ
	int "C907 frequency in MHz set before the run, a multiple of 24 (0 keeps the one sunxi_clk_init() chose)"
	depends on COMPONENT_COREMARK
	default 0
```

## components/memtester/Kconfig
```kconfig
# SPDX-License-Identifier: GPL-2.0+

config COMPONENT_MEMTESTER
	bool "memtester (DRAM test)"
	help
	  The tests of memtester 4.6.0 (components/memtester) and memtester_run(), which runs them
	  on a region of memory the application gives it.
```

## configs/avaota-a1/dram_defconfig
```kconfig
# SPDX-License-Identifier: GPL-2.0+
CONFIG_BUILD_RELEASE=y
CONFIG_OPTIMIZE_FOR_SIZE=y
CONFIG_APP_DRAM=y
CONFIG_APP_DRAM_TEXT_BASE=0x42000000
CONFIG_APP_DRAM_MAX_SIZE=0x01000000
CONFIG_ARCH_ARM32=y
CONFIG_CPU_ARMV8_2=y
CONFIG_BACKTRACE_MIN=y
CONFIG_ARCH_DCACHE=y
CONFIG_ARCH_ICACHE=y
CONFIG_SYS_BOARD="avaota-a1"
CONFIG_SPL_BIN_TEXT_BASE=0x00044000
CONFIG_SPL_BIN_MAX_SIZE=0x00018000
CONFIG_SPL_FEL_TEXT_BASE=0x00020000
CONFIG_SPL_FEL_MAX_SIZE=0x00020000
CONFIG_DRIVER_CLK=y
CONFIG_DRIVER_DMA=y
CONFIG_DRIVER_GPIO_V2_POW=y
CONFIG_DRIVER_I2C=y
CONFIG_DRIVER_MMC=y
CONFIG_DRIVER_MMC_TUNING=y
CONFIG_DRIVER_MTD=y
CONFIG_DRIVER_MTD_SPI_NOR=y
CONFIG_DRIVER_PMIC_AXP=y
CONFIG_DRIVER_PWM=y
CONFIG_DRIVER_DRAM=y
CONFIG_DRIVER_REMOTEPROC=y
CONFIG_DRIVER_RTC=y
CONFIG_DRIVER_SERIAL=y
CONFIG_DRIVER_SID=y
CONFIG_DRIVER_SPI=y
CONFIG_CLI_HEAP_STORAGE=y
CONFIG_FATFS_LFN_HEAP=y
CONFIG_FATFS_CACHE=y
CONFIG_BOARD_AVAOTA_A1=y
```

## configs/avaota-a1_defconfig
```kconfig
# SPDX-License-Identifier: GPL-2.0+
CONFIG_BUILD_RELEASE=y
CONFIG_OPTIMIZE_FOR_SIZE=y
CONFIG_ARCH_ARM32=y
CONFIG_CPU_ARMV8_2=y
CONFIG_BACKTRACE_MIN=y
CONFIG_ARCH_DCACHE=y
CONFIG_ARCH_ICACHE=y
CONFIG_SYS_BOARD="avaota-a1"
CONFIG_SPL_BIN_TEXT_BASE=0x00044000
CONFIG_SPL_BIN_MAX_SIZE=0x00018000
CONFIG_SPL_FEL_TEXT_BASE=0x00020000
CONFIG_SPL_FEL_MAX_SIZE=0x00020000
CONFIG_DRIVER_CLK=y
CONFIG_DRIVER_DMA=y
CONFIG_DRIVER_GPIO_V2=y
CONFIG_DRIVER_I2C=y
CONFIG_DRIVER_MMC=y
CONFIG_DRIVER_MTD=y
CONFIG_DRIVER_PMIC_AXP=y
CONFIG_DRIVER_PWM=y
CONFIG_DRIVER_DRAM=y
CONFIG_DRIVER_REMOTEPROC=y
CONFIG_DRIVER_RTC=y
CONFIG_DRIVER_SERIAL=y
CONFIG_DRIVER_SID=y
CONFIG_DRIVER_SPI=y
CONFIG_FATFS_CACHE=y
CONFIG_BOARD_AVAOTA_A1=y
```

## configs/avaota-m1_defconfig
```kconfig
# SPDX-License-Identifier: GPL-2.0+
CONFIG_BUILD_RELEASE=y
CONFIG_OPTIMIZE_FOR_SIZE=y
CONFIG_ARCH_ARM32=y
CONFIG_CPU_ARMV8=y
CONFIG_BACKTRACE_MIN=y
CONFIG_ARCH_DCACHE=y
CONFIG_SYS_BOARD="avaota-m1"
CONFIG_SPL_BIN_TEXT_BASE=0x00044000
CONFIG_SPL_BIN_MAX_SIZE=0x00023000
CONFIG_SPL_FEL_TEXT_BASE=0x0004c000
CONFIG_SPL_FEL_MAX_SIZE=0x00023000
CONFIG_DRIVER_CLK=y
CONFIG_DRIVER_DMA=y
CONFIG_DRIVER_GPIO_V4=y
CONFIG_DRIVER_I2C=y
CONFIG_DRIVER_MMC=y
CONFIG_DRIVER_MTD=y
CONFIG_DRIVER_PMIC_AXP=y
CONFIG_DRIVER_PWM=y
CONFIG_DRIVER_DRAM=y
CONFIG_DRIVER_REMOTEPROC=y
CONFIG_DRIVER_RTC=y
CONFIG_DRIVER_SERIAL=y
CONFIG_DRIVER_SID=y
CONFIG_DRIVER_SPI=y
CONFIG_FATFS_CACHE=y
CONFIG_BOARD_AVAOTA_M1=y
```

## configs/dongshanpi-aict_defconfig
```kconfig
# SPDX-License-Identifier: GPL-2.0+
CONFIG_BUILD_RELEASE=y
CONFIG_OPTIMIZE_FOR_SIZE=y
CONFIG_ARCH_ARM32=y
CONFIG_CPU_CORTEX_A7=y
CONFIG_BACKTRACE_MIN=y
CONFIG_ARM_HARDFP=y
CONFIG_SYS_BOARD="dongshanpi-aict"
CONFIG_SPL_BIN_TEXT_BASE=0x00020000
CONFIG_SPL_BIN_MAX_SIZE=0x00020000
CONFIG_SPL_FEL_TEXT_BASE=0x00028000
CONFIG_SPL_FEL_MAX_SIZE=0x00019000
CONFIG_DRIVER_CLK=y
CONFIG_DRIVER_DMA=y
CONFIG_DRIVER_GPIO_V2=y
CONFIG_DRIVER_I2C=y
CONFIG_DRIVER_MTD=y
CONFIG_DRIVER_PWM=y
CONFIG_DRIVER_DRAM=y
CONFIG_DRIVER_REMOTEPROC=y
CONFIG_DRIVER_HW_RANDOM=y
CONFIG_DRIVER_RTC=y
CONFIG_DRIVER_SDHCI=y
CONFIG_DRIVER_SERIAL=y
CONFIG_DRIVER_SID=y
CONFIG_DRIVER_SPI=y
CONFIG_BOARD_DONGSHANPI_AICT=y
```

## configs/longanpi-3h/sram_defconfig
```kconfig
# SPDX-License-Identifier: GPL-2.0+
CONFIG_BUILD_RELEASE=y
CONFIG_OPTIMIZE_FOR_SIZE=y
CONFIG_APP_SRAM=y
CONFIG_ARCH_ARM32=y
CONFIG_CPU_ARMV8=y
CONFIG_ARCH_MINSTACK=y
CONFIG_BACKTRACE_MIN=y
CONFIG_ARCH_ICACHE=y
CONFIG_SYS_BOARD="longanpi-3h"
CONFIG_SPL_BIN_TEXT_BASE=0x00020000
CONFIG_SPL_BIN_MAX_SIZE=0x00020000
CONFIG_SPL_FEL_TEXT_BASE=0x00028000
CONFIG_SPL_FEL_MAX_SIZE=0x00020000
CONFIG_DRIVER_CLK=y
CONFIG_DRIVER_DMA=y
CONFIG_DRIVER_GPIO_V1=y
CONFIG_DRIVER_I2C=y
CONFIG_DRIVER_MTD=y
CONFIG_DRIVER_MTD_SPI_NOR=y
CONFIG_DRIVER_PMIC_AXP=y
CONFIG_DRIVER_PWM=y
CONFIG_DRIVER_DRAM=y
CONFIG_DRIVER_RTC=y
CONFIG_DRIVER_MMC=y
CONFIG_DRIVER_SERIAL=y
CONFIG_DRIVER_SID=y
CONFIG_DRIVER_SPI=y
CONFIG_BOARD_LONGANPI_3H=y
```

## configs/tinyvision/sram_defconfig
```kconfig
# SPDX-License-Identifier: GPL-2.0+
CONFIG_BUILD_RELEASE=y
CONFIG_OPTIMIZE_FOR_SIZE=y
CONFIG_APP_SRAM=y
CONFIG_ARCH_ARM32=y
CONFIG_CPU_CORTEX_A7=y
CONFIG_BACKTRACE_MIN=y
CONFIG_ARM_HARDFP=y
CONFIG_ARCH_ICACHE=y
CONFIG_SYS_BOARD="tinyvision"
CONFIG_SPL_BIN_TEXT_BASE=0x00020000
CONFIG_SPL_BIN_MAX_SIZE=0x00020000
CONFIG_SPL_FEL_TEXT_BASE=0x00028000
CONFIG_SPL_FEL_MAX_SIZE=0x00019000
CONFIG_DRIVER_CLK=y
CONFIG_DRIVER_DMA=y
CONFIG_DRIVER_GPIO_V2=y
CONFIG_DRIVER_I2C=y
CONFIG_DRIVER_GIC=y
CONFIG_DRIVER_MTD=y
CONFIG_DRIVER_MTD_SPI_NAND=y
CONFIG_DRIVER_PWM=y
CONFIG_DRIVER_DRAM=y
CONFIG_DRIVER_REMOTEPROC=y
CONFIG_DRIVER_RTC=y
CONFIG_DRIVER_MMC=y
CONFIG_DRIVER_SERIAL=y
CONFIG_DRIVER_SID=y
CONFIG_DRIVER_SOC=y
CONFIG_DRIVER_SPI=y
CONFIG_DRIVER_USB=y
CONFIG_BOARD_TINYVISION=y
```

## configs/tlt153-minievm_defconfig
```kconfig
# SPDX-License-Identifier: GPL-2.0+
CONFIG_BUILD_RELEASE=y
CONFIG_OPTIMIZE_FOR_SIZE=y
CONFIG_ARCH_ARM32=y
CONFIG_CPU_CORTEX_A7=y
CONFIG_BACKTRACE_MIN=y
CONFIG_ARCH_ICACHE=y
CONFIG_SYS_BOARD="tlt153-minievm"
CONFIG_SPL_BIN_TEXT_BASE=0x00040000
CONFIG_SPL_BIN_MAX_SIZE=0x00028000
CONFIG_SPL_FEL_TEXT_BASE=0x00048000
CONFIG_SPL_FEL_MAX_SIZE=0x00020000
CONFIG_DRIVER_CLK=y
CONFIG_DRIVER_DMA=y
CONFIG_DRIVER_GPIO_V3=y
CONFIG_DRIVER_I2C=y
CONFIG_DRIVER_MMC=y
CONFIG_DRIVER_MTD=y
CONFIG_DRIVER_PWM=y
CONFIG_DRIVER_DRAM=y
CONFIG_DRIVER_RTC=y
CONFIG_DRIVER_SERIAL=y
CONFIG_DRIVER_SID=y
CONFIG_DRIVER_SPI=y
CONFIG_FATFS_CACHE=y
CONFIG_BOARD_TLT153_MINIEVM=y
```

## configs/yuzukineko_rv32_defconfig
```kconfig
# SPDX-License-Identifier: GPL-2.0+
CONFIG_ARCH_RISCV32=y
CONFIG_ARCH_DCACHE=y
CONFIG_ARCH_ICACHE=y
CONFIG_BACKTRACE_MIN=y
CONFIG_DRIVER_CLK=y
CONFIG_DRIVER_DMA=y
CONFIG_DRIVER_GPIO_V2=y
CONFIG_DRIVER_I2C=y
CONFIG_DRIVER_CLIC=y
CONFIG_DRIVER_MMC=y
CONFIG_DRIVER_MTD=y
CONFIG_DRIVER_PWM=y
CONFIG_DRIVER_PSRAM=y
CONFIG_DRIVER_RTC=y
CONFIG_DRIVER_SERIAL=y
CONFIG_DRIVER_SID=y
CONFIG_DRIVER_SPI=y
CONFIG_SYS_BOARD="yuzukineko"
CONFIG_SPL_BIN_TEXT_BASE=0x00020000
CONFIG_SPL_BIN_MAX_SIZE=0x10000
CONFIG_SPL_FEL_TEXT_BASE=0x00020000
CONFIG_SPL_FEL_MAX_SIZE=0x10000
CONFIG_BUILD_RELEASE=y
CONFIG_OPTIMIZE_FOR_SIZE=y
```

## core/Kconfig
```kconfig
# SPDX-License-Identifier: GPL-2.0+

menu "Core services"

config UART_EARLY_LOG
	bool "Buffer UART logs before console initialization"
	depends on DRIVER_SERIAL
	help
	  Keep log output generated before the UART console probe in memory and
	  flush it after the console hardware has been initialized.

config UART_EARLY_LOG_BUFFER_SIZE
	int "Early UART log buffer size"
	depends on UART_EARLY_LOG
	default 16384
	range 256 1048576
	help
	  Number of bytes reserved for log output emitted before the UART
	  console is ready.

config CLI_HEAP_STORAGE
	bool "Allocate interactive CLI buffers from the heap"
	help
	  Allocate the command history and line editor state on demand from the
	  heap. This reduces permanent SRAM use by about 3 KiB, and requires
	  malloc_init() before the CLI is entered.

config VT
	bool "Text console on a frame buffer"
	help
	  Build the ANSI capable text console (vt_init() and friends, include/vt.h)
	  that draws an 8x16 font into a XRGB8888 frame buffer. Everything written
	  to the log UART is mirrored to it after vt_init(), colors included.

config VT_EARLY_BUFFER_SIZE
	int "Text kept for the console before vt_init()"
	depends on VT
	default 4096
	range 256 65536
	help
	  Log output written before vt_init() is stored in this many bytes of
	  SRAM and drawn on the screen when the console starts. Escape sequences
	  count; what does not fit is dropped.

endmenu
```

## drivers/Kconfig
```kconfig
# SPDX-License-Identifier: GPL-2.0+

menu "Device drivers"

source "drivers/clk/Kconfig"
source "drivers/dma/Kconfig"
source "drivers/gpio/Kconfig"
source "drivers/i2c/Kconfig"
source "drivers/intc/Kconfig"
source "drivers/mmc/Kconfig"
source "drivers/mtd/Kconfig"
source "drivers/pmu/Kconfig"
source "drivers/pwm/Kconfig"
source "drivers/dram/Kconfig"
source "drivers/remoteproc/Kconfig"
source "drivers/rtc/Kconfig"
source "drivers/serial/Kconfig"
source "drivers/soc/Kconfig"
source "drivers/spi/Kconfig"
source "drivers/usb/Kconfig"
source "drivers/ufs/Kconfig"

endmenu
```

## drivers/clk/Kconfig
```kconfig
# SPDX-License-Identifier: GPL-2.0+

menu "Clock driver"

config DRIVER_CLK
	bool "Clock controller support"

choice
	prompt "Clock driver log level"
	default DRIVER_CLK_LOG_TRACE if BUILD_TRACE
	default DRIVER_CLK_LOG_DEBUG if BUILD_DEBUG
	default DRIVER_CLK_LOG_GLOBAL
	depends on DRIVER_CLK

config DRIVER_CLK_LOG_GLOBAL
	bool "Inherit global log level"

config DRIVER_CLK_LOG_MUTE
	bool "Mute"

config DRIVER_CLK_LOG_ERROR
	bool "Error"

config DRIVER_CLK_LOG_WARNING
	bool "Warning"

config DRIVER_CLK_LOG_INFO
	bool "Info"

config DRIVER_CLK_LOG_DEBUG
	bool "Debug"

config DRIVER_CLK_LOG_TRACE
	bool "Trace"

config DRIVER_CLK_LOG_BACKTRACE
	bool "Backtrace"

endchoice

endmenu
```

## drivers/display/Kconfig
```kconfig
# SPDX-License-Identifier: GPL-2.0+

menu "Display driver"

config DRIVER_DISPLAY
	bool "Display (TCON + DE UI passthrough) support"

config DRIVER_DISPLAY_DSI
	bool "MIPI DSI output"
	depends on DRIVER_DISPLAY
	select DRIVER_DISPLAY_DPHY
	help
	  Needs a chip with a DSI host (not V861). Leave it off to build without the DSI host.

config DRIVER_DISPLAY_LVDS
	bool "LVDS output"
	depends on DRIVER_DISPLAY
	select DRIVER_DISPLAY_DPHY
	help
	  Needs a chip with LVDS pads (not V861). Leave it off to build without the LVDS paths.

# the LVDS and DSI outputs share one combo D-PHY
config DRIVER_DISPLAY_DPHY
	bool
	depends on DRIVER_DISPLAY

choice
	prompt "Display driver log level"
	default DRIVER_DISPLAY_LOG_TRACE if BUILD_TRACE
	default DRIVER_DISPLAY_LOG_DEBUG if BUILD_DEBUG
	default DRIVER_DISPLAY_LOG_GLOBAL
	depends on DRIVER_DISPLAY

config DRIVER_DISPLAY_LOG_GLOBAL
	bool "Inherit global log level"

config DRIVER_DISPLAY_LOG_MUTE
	bool "Mute"

config DRIVER_DISPLAY_LOG_ERROR
	bool "Error"

config DRIVER_DISPLAY_LOG_WARNING
	bool "Warning"

config DRIVER_DISPLAY_LOG_INFO
	bool "Info"

config DRIVER_DISPLAY_LOG_DEBUG
	bool "Debug"

config DRIVER_DISPLAY_LOG_TRACE
	bool "Trace"

config DRIVER_DISPLAY_LOG_BACKTRACE
	bool "Backtrace"

endchoice

endmenu
```

## drivers/dma/Kconfig
```kconfig
# SPDX-License-Identifier: GPL-2.0+

menu "DMA driver"

config DRIVER_DMA
	bool "DMA controller support"

choice
	prompt "DMA driver log level"
	default DRIVER_DMA_LOG_TRACE if BUILD_TRACE
	default DRIVER_DMA_LOG_DEBUG if BUILD_DEBUG
	default DRIVER_DMA_LOG_GLOBAL
	depends on DRIVER_DMA

config DRIVER_DMA_LOG_GLOBAL
	bool "Inherit global log level"

config DRIVER_DMA_LOG_MUTE
	bool "Mute"

config DRIVER_DMA_LOG_ERROR
	bool "Error"

config DRIVER_DMA_LOG_WARNING
	bool "Warning"

config DRIVER_DMA_LOG_INFO
	bool "Info"

config DRIVER_DMA_LOG_DEBUG
	bool "Debug"

config DRIVER_DMA_LOG_TRACE
	bool "Trace"

config DRIVER_DMA_LOG_BACKTRACE
	bool "Backtrace"

endchoice

endmenu
```

## drivers/dram/Kconfig
```kconfig
# SPDX-License-Identifier: GPL-2.0+

menu "DRAM driver"

config DRIVER_DRAM
	bool "DRAM controller support"

choice
	prompt "DRAM driver log level"
	default DRIVER_DRAM_LOG_TRACE if BUILD_TRACE
	default DRIVER_DRAM_LOG_DEBUG if BUILD_DEBUG
	default DRIVER_DRAM_LOG_GLOBAL
	depends on DRIVER_DRAM

config DRIVER_DRAM_LOG_GLOBAL
	bool "Inherit global log level"

config DRIVER_DRAM_LOG_MUTE
	bool "Mute"

config DRIVER_DRAM_LOG_ERROR
	bool "Error"

config DRIVER_DRAM_LOG_WARNING
	bool "Warning"

config DRIVER_DRAM_LOG_INFO
	bool "Info"

config DRIVER_DRAM_LOG_DEBUG
	bool "Debug"

config DRIVER_DRAM_LOG_TRACE
	bool "Trace"

config DRIVER_DRAM_LOG_BACKTRACE
	bool "Backtrace"

endchoice

endmenu
```

## drivers/gpio/Kconfig
```kconfig
# SPDX-License-Identifier: GPL-2.0+

menu "GPIO driver"

choice
	prompt "GPIO controller version"
	optional

config DRIVER_GPIO_V1
	bool "GPIO controller v1"

config DRIVER_GPIO_V2
	bool "GPIO controller v2"

config DRIVER_GPIO_V2_POW
	bool "GPIO controller v2-pow (withstand-voltage mode)"

config DRIVER_GPIO_V3
	bool "GPIO controller v3"

config DRIVER_GPIO_V4
	bool "GPIO controller v4"

endchoice

choice
	prompt "GPIO driver log level"
	default DRIVER_GPIO_LOG_TRACE if BUILD_TRACE
	default DRIVER_GPIO_LOG_DEBUG if BUILD_DEBUG
	default DRIVER_GPIO_LOG_GLOBAL
	depends on DRIVER_GPIO_V1 || DRIVER_GPIO_V2 || DRIVER_GPIO_V2_POW || DRIVER_GPIO_V3 || DRIVER_GPIO_V4

config DRIVER_GPIO_LOG_GLOBAL
	bool "Inherit global log level"

config DRIVER_GPIO_LOG_MUTE
	bool "Mute"

config DRIVER_GPIO_LOG_ERROR
	bool "Error"

config DRIVER_GPIO_LOG_WARNING
	bool "Warning"

config DRIVER_GPIO_LOG_INFO
	bool "Info"

config DRIVER_GPIO_LOG_DEBUG
	bool "Debug"

config DRIVER_GPIO_LOG_TRACE
	bool "Trace"

config DRIVER_GPIO_LOG_BACKTRACE
	bool "Backtrace"

endchoice

endmenu
```
