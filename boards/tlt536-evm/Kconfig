## drivers/i2c/Kconfig
```kconfig
# SPDX-License-Identifier: GPL-2.0+

menu "I2C driver"

config DRIVER_I2C
	bool "I2C controller support"

choice
	prompt "I2C driver log level"
	default DRIVER_I2C_LOG_TRACE if BUILD_TRACE
	default DRIVER_I2C_LOG_DEBUG if BUILD_DEBUG
	default DRIVER_I2C_LOG_GLOBAL
	depends on DRIVER_I2C

config DRIVER_I2C_LOG_GLOBAL
	bool "Inherit global log level"

config DRIVER_I2C_LOG_MUTE
	bool "Mute"

config DRIVER_I2C_LOG_ERROR
	bool "Error"

config DRIVER_I2C_LOG_WARNING
	bool "Warning"

config DRIVER_I2C_LOG_INFO
	bool "Info"

config DRIVER_I2C_LOG_DEBUG
	bool "Debug"

config DRIVER_I2C_LOG_TRACE
	bool "Trace"

config DRIVER_I2C_LOG_BACKTRACE
	bool "Backtrace"

endchoice

endmenu
```

## drivers/intc/Kconfig
```kconfig
# SPDX-License-Identifier: GPL-2.0+

menu "Interrupt controller driver"

config DRIVER_INTC
	bool

choice
	prompt "RISC-V interrupt controller"
	depends on ARCH_RISCV
	optional

config DRIVER_CLIC
	bool "Core-local interrupt controller support"
	select DRIVER_INTC

config DRIVER_PLIC
	bool "Platform-level interrupt controller support"
	depends on !ARCH_CPU_E907
	select DRIVER_INTC

endchoice

config DRIVER_GIC
	bool "Generic interrupt controller support"
	depends on ARCH_ARM32
	select DRIVER_INTC

choice
	prompt "Interrupt controller driver log level"
	default DRIVER_INTC_LOG_TRACE if BUILD_TRACE
	default DRIVER_INTC_LOG_DEBUG if BUILD_DEBUG
	default DRIVER_INTC_LOG_GLOBAL
	depends on DRIVER_CLIC || DRIVER_PLIC || DRIVER_GIC

config DRIVER_INTC_LOG_GLOBAL
	bool "Inherit global log level"

config DRIVER_INTC_LOG_MUTE
	bool "Mute"

config DRIVER_INTC_LOG_ERROR
	bool "Error"

config DRIVER_INTC_LOG_WARNING
	bool "Warning"

config DRIVER_INTC_LOG_INFO
	bool "Info"

config DRIVER_INTC_LOG_DEBUG
	bool "Debug"

config DRIVER_INTC_LOG_TRACE
	bool "Trace"

config DRIVER_INTC_LOG_BACKTRACE
	bool "Backtrace"

endchoice

endmenu
```
