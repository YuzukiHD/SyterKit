/dts-v1/;

/ {
	#address-cells = <1>;
	#size-cells = <1>;

	clock-controller@1000 {
		compatible = "allwinner,sun50iw10-ccu";
		reg =
			<0x1000 0x7c0>,
			<0x2000 0x258>,
			<0x3000 0x164>,
			<0x4000 0x44>;
		reg-names = "ccu", "sysctrl", "r-prcm", "iommu";
		status = "okay";
	};
};
