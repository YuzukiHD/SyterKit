## drivers/ufs/Kconfig
```kconfig
# SPDX-License-Identifier: GPL-2.0+

menu "UFS driver"

config DRIVER_UFS
	bool "UFS storage support"
	help
	  Enable the layered UFS stack.  The ufshc layer implements UFSHCI,
	  the SCSI layer implements block commands, and the top-level UFS
	  layer exposes the storage device to board code.

choice
	prompt "UFS driver log level"
	default DRIVER_UFS_LOG_TRACE if BUILD_TRACE
	default DRIVER_UFS_LOG_DEBUG if BUILD_DEBUG
	default DRIVER_UFS_LOG_GLOBAL
	depends on DRIVER_UFS

config DRIVER_UFS_LOG_GLOBAL
	bool "Inherit global log level"

config DRIVER_UFS_LOG_MUTE
	bool "Mute"

config DRIVER_UFS_LOG_ERROR
	bool "Error"

config DRIVER_UFS_LOG_WARNING
	bool "Warning"

config DRIVER_UFS_LOG_INFO
	bool "Info"

config DRIVER_UFS_LOG_DEBUG
	bool "Debug"

config DRIVER_UFS_LOG_TRACE
	bool "Trace"

config DRIVER_UFS_LOG_BACKTRACE
	bool "Backtrace"

endchoice

source "drivers/ufs/host/Kconfig"

endmenu
```

## drivers/ufs/host/Kconfig
```kconfig
# SPDX-License-Identifier: GPL-2.0+

choice DRIVER_UFS_HOST_SUNXI_CHIP
	prompt "Allwinner UFS host chip"
	depends on DRIVER_UFS

config DRIVER_UFS_HOST_SUN60IW2
	bool "Sun60IW2P1"
	depends on SOC_SUN60IW2
	select DRIVER_SID
	help
	  Use the Sun60IW2P1 BGR-based UFS CCU and PHY sequence.

endchoice
```

## drivers/usb/Kconfig
```kconfig
# SPDX-License-Identifier: GPL-2.0+

menu "USB driver"

config DRIVER_USB
	bool "Allwinner USB device controller support"
	depends on DRIVER_INTC

if DRIVER_USB

config DRIVER_USB_FUNCTION_WINUSB
	bool "WinUSB device function"
	default y
	help
	  Build the minimal WinUSB function. Additional USB functions register
	  through the USB function registry instead of modifying the controller.

config DRIVER_USB_FUNCTION_FEL
	bool "Sunxi FEL device function"
	depends on DRIVER_SID
	default y
	help
	  Build the Sunxi FEL USB device function. It implements the AWUC/AWUS
	  bulk transport and the memory read, write and execute commands used by
	  libefex.

endif

choice
	prompt "USB driver log level"
	default DRIVER_USB_LOG_TRACE if BUILD_TRACE
	default DRIVER_USB_LOG_DEBUG if BUILD_DEBUG
	default DRIVER_USB_LOG_GLOBAL
	depends on DRIVER_USB

config DRIVER_USB_LOG_GLOBAL
	bool "Inherit global log level"

config DRIVER_USB_LOG_MUTE
	bool "Mute"

config DRIVER_USB_LOG_ERROR
	bool "Error"

config DRIVER_USB_LOG_WARNING
	bool "Warning"

config DRIVER_USB_LOG_INFO
	bool "Info"

config DRIVER_USB_LOG_DEBUG
	bool "Debug"

config DRIVER_USB_LOG_TRACE
	bool "Trace"

config DRIVER_USB_LOG_BACKTRACE
	bool "Backtrace"

endchoice

endmenu
```

## drivers/usb/module/Kconfig
```kconfig
# SPDX-License-Identifier: GPL-2.0+

config DRIVER_USB_MASS_STORAGE
	bool "USB mass-storage support"
	depends on DRIVER_USB
```

## dts/bindings/clock/allwinner,sun20iw1-ccu.yaml
```yaml
$schema: http://devicetree.org/meta-schemas/core.yaml#
title: Allwinner sun20iw1 clock controller used by SyterKit

properties:
  compatible:
    const: allwinner,sun20iw1-ccu
  reg:
    type: reg
  reg-names:
    type: string-array
    const: [ccu]
    description: Ordered as ccu.
  status:
    type: string
    enum: [okay, disabled]

required:
  - compatible
  - reg
  - reg-names

dt2c,device: true
```

## dts/bindings/clock/allwinner,sun300iw1-ccu.yaml
```yaml
$schema: http://devicetree.org/meta-schemas/core.yaml#
title: Allwinner sun300iw1 clock controller used by SyterKit

properties:
  compatible:
    const: allwinner,sun300iw1-ccu
  reg:
    type: reg
  reg-names:
    type: string-array
    const: [app-ccu, aon-ccu]
    description: Ordered as app-ccu, aon-ccu.
  status:
    type: string
    enum: [okay, disabled]

required:
  - compatible
  - reg
  - reg-names

dt2c,device: true
```

## dts/bindings/clock/allwinner,sun50iw10-ccu.yaml
```yaml
$schema: http://devicetree.org/meta-schemas/core.yaml#
title: Allwinner sun50iw10 clock controller used by SyterKit

properties:
  compatible:
    const: allwinner,sun50iw10-ccu
  reg:
    type: reg
  reg-names:
    type: string-array
    const: [ccu, r-prcm, sysctrl, iommu]
    description: Ordered as ccu, r-prcm, sysctrl, iommu.
  status:
    type: string
    enum: [okay, disabled]

required: [compatible, reg, reg-names]
dt2c,device: true
```

## dts/bindings/clock/allwinner,sun50iw9-ccu.yaml
```yaml
$schema: http://devicetree.org/meta-schemas/core.yaml#
title: Allwinner sun50iw9 clock controller used by SyterKit

properties:
  compatible:
    const: allwinner,sun50iw9-ccu
  reg:
    type: reg
  reg-names:
    type: string-array
    const: [ccu, r-prcm, iommu]
    description: Ordered as ccu, r-prcm, iommu.
  status:
    type: string
    enum: [okay, disabled]

required: [compatible, reg, reg-names]
dt2c,device: true
```

## dts/bindings/clock/allwinner,sun55iw3-ccu.yaml
```yaml
$schema: http://devicetree.org/meta-schemas/core.yaml#
title: Allwinner sun55iw3 clock controller used by SyterKit

properties:
  compatible:
    const: allwinner,sun55iw3-ccu
  reg:
    type: reg
  reg-names:
    type: string-array
    const: [ccu, cpu-sys-cfg, r-prcm, iommu]
    description: Ordered as ccu, cpu-sys-cfg, r-prcm, iommu.
  status:
    type: string
    enum: [okay, disabled]

required: [compatible, reg, reg-names]
dt2c,device: true
```

## dts/bindings/clock/allwinner,sun55iw6-ccu.yaml
```yaml
$schema: http://devicetree.org/meta-schemas/core.yaml#
title: Allwinner sun55iw6 clock controller used by SyterKit

properties:
  compatible:
    const: allwinner,sun55iw6-ccu
  reg:
    type: reg
  reg-names:
    type: string-array
    const: [ccu, cpu-pll]
    description: Ordered as ccu, cpu-pll.
  status:
    type: string
    enum: [okay, disabled]

required: [compatible, reg, reg-names]
dt2c,device: true
```

## dts/bindings/clock/allwinner,sun60iw2-ccu.yaml
```yaml
$schema: http://devicetree.org/meta-schemas/core.yaml#
title: Allwinner sun60iw2 clock controller used by SyterKit

properties:
  compatible:
    const: allwinner,sun60iw2-ccu
  reg:
    type: reg
  reg-names:
    type: string-array
    const: [ccu, cpu-pll, rtc]
    description: Ordered as ccu, cpu-pll, rtc.
  status:
    type: string
    enum: [okay, disabled]

required: [compatible, reg, reg-names]
dt2c,device: true
```

## dts/bindings/clock/allwinner,sun8iw20-ccu.yaml
```yaml
$schema: http://devicetree.org/meta-schemas/core.yaml#
title: Allwinner sun8iw20 clock controller used by SyterKit

properties:
  compatible:
    const: allwinner,sun8iw20-ccu
  reg:
    type: reg
  reg-names:
    type: string-array
    const: [ccu]
    description: Ordered as ccu.
  status:
    type: string
    enum: [okay, disabled]

required: [compatible, reg, reg-names]
dt2c,device: true
```

## dts/bindings/clock/allwinner,sun8iw22-ccu.yaml
```yaml
$schema: http://devicetree.org/meta-schemas/core.yaml#
title: Allwinner sun8iw22 clock controller used by SyterKit

properties:
  compatible:
    const: allwinner,sun8iw22-ccu
  reg:
    type: reg
  reg-names:
    type: string-array
    const: [ccu, cpu-pll]
    description: Ordered as ccu, cpu-pll.
  status:
    type: string
    enum: [okay, disabled]

required: [compatible, reg, reg-names]
dt2c,device: true
```

## dts/bindings/display/allwinner,sunxi-backlight.yaml
```yaml
$schema: http://devicetree.org/meta-schemas/core.yaml#
title: Display backlight (GPIO enable or PWM) used by SyterKit

properties:
  compatible:
    const: allwinner,sunxi-backlight
  allwinner,pwm:
    type: phandle
  allwinner,pwm-channel:
    type: uint32
  allwinner,pwm-period-ns:
    type: uint32
  enable-gpios:
    type: uint32-array
  allwinner,active-high:
    type: uint32
  allwinner,brightness:
    type: uint32
  status:
    type: string
    enum: [okay, disabled]

required:
  - compatible

dt2c,device: true
```

## dts/bindings/display/allwinner,sunxi-combo-dphy.yaml
```yaml
$schema: http://devicetree.org/meta-schemas/core.yaml#
title: Allwinner combo D-PHY (MIPI D-PHY / LVDS) used by SyterKit

properties:
  compatible:
    const: allwinner,sunxi-combo-dphy
  reg:
    type: reg
  allwinner,variant:
    type: string
  allwinner,phy-id:
    type: uint32
  clock-frequency:
    type: uint32
  allwinner,module-div:
    type: uint32
  allwinner,module-clock:
    type: uint32-array
  allwinner,clock-gate:
    type: uint32-array
  allwinner,reset:
    type: uint32-array
  status:
    type: string
    enum: [okay, disabled]

required:
  - compatible
  - reg
  - allwinner,variant
  - allwinner,clock-gate

dt2c,device: true
```

## dts/bindings/display/allwinner,sunxi-de.yaml
```yaml
$schema: http://devicetree.org/meta-schemas/core.yaml#
title: Allwinner display engine (UI layer passthrough) used by SyterKit

properties:
  compatible:
    const: allwinner,sunxi-de
  reg:
    type: reg
  allwinner,variant:
    type: string
  allwinner,clock-gate:
    type: uint32-array
  allwinner,reset:
    type: uint32-array
  allwinner,module-clock:
    type: uint32-array
  clock-frequency:
    type: uint32
  allwinner,de-port:
    type: uint32
  status:
    type: string
    enum: [okay, disabled]

required:
  - compatible
  - reg
  - allwinner,variant
  - allwinner,clock-gate
  - allwinner,reset
  - allwinner,module-clock

dt2c,device: true
```

## dts/bindings/display/allwinner,sunxi-display.yaml
```yaml
$schema: http://devicetree.org/meta-schemas/core.yaml#
title: Allwinner display pipeline (DE UI passthrough -> TCON -> output -> panel) used by SyterKit

properties:
  compatible:
    const: allwinner,sunxi-display
  allwinner,variant:
    type: string
  allwinner,pll-video:
    type: uint32-array
  allwinner,pll-peri:
    type: uint32-array
  allwinner,de:
    type: phandle
  allwinner,tcon:
    type: phandle
  allwinner,tcon-top:
    type: phandle
  allwinner,output:
    type: phandle
  allwinner,panel:
    type: phandle
  allwinner,backlight:
    type: phandle
  status:
    type: string
    enum: [okay, disabled]

required:
  - compatible
  - allwinner,variant
  - allwinner,pll-video
  - allwinner,pll-peri
  - allwinner,de
  - allwinner,tcon
  - allwinner,output
  - allwinner,panel

dt2c,device: true
```

## dts/bindings/display/allwinner,sunxi-i8080.yaml
```yaml
$schema: http://devicetree.org/meta-schemas/core.yaml#
title: Allwinner i8080 (TCON CPU interface) output used by SyterKit

properties:
  compatible:
    const: allwinner,sunxi-i8080
  allwinner,cpu-mode:
    type: uint32
    description: TCON0_CPU_MODE, 0 18 bit, 2/4/6/8 16 bit variants, 10 9 bit, 12 8 bit 256K, 14 8 bit 65K
  allwinner,cpu-trigger:
    type: boolean
    description: frames are sent by trigger (sunxi_display_poll) instead of streaming
  allwinner,cpu-te:
    type: uint32
    description: 0 no TE, 1 counter plus TE, 2 TE only (needs allwinner,cpu-trigger)
  allwinner,rgb-swap:
    type: uint32
  allwinner,rb-swap:
    type: uint32
  allwinner,clk-phase:
    type: uint32
  allwinner,io-adjust:
    type: uint32
  allwinner,drive-level:
    type: uint32
  pinctrl-names:
    type: string
  pinctrl-0:
    type: phandle
  status:
    type: string
    enum: [okay, disabled]

required:
  - compatible
  - pinctrl-names
  - pinctrl-0

dt2c,device: true
```

## dts/bindings/display/allwinner,sunxi-lvds.yaml
```yaml
$schema: http://devicetree.org/meta-schemas/core.yaml#
title: Allwinner LVDS output of the TCON used by SyterKit

properties:
  compatible:
    const: allwinner,sunxi-lvds
  allwinner,phy:
    type: phandle
  allwinner,reset:
    type: uint32-array
  allwinner,dual-link:
    type: boolean
  allwinner,jeida:
    type: boolean
  allwinner,drive-level:
    type: uint32
  pinctrl-names:
    type: string
  pinctrl-0:
    type: phandle
  status:
    type: string
    enum: [okay, disabled]

required:
  - compatible
  - allwinner,phy

dt2c,device: true
```

## dts/bindings/display/allwinner,sunxi-mipi-dsi.yaml
```yaml
$schema: http://devicetree.org/meta-schemas/core.yaml#
title: Allwinner MIPI DSI host used by SyterKit

properties:
  compatible:
    const: allwinner,sunxi-mipi-dsi
  reg:
    type: reg
  allwinner,variant:
    type: string
  allwinner,dsi-id:
    type: uint32
  clock-frequency:
    type: uint32
  allwinner,module-clock:
    type: uint32-array
  allwinner,clock-gate:
    type: uint32-array
  allwinner,reset:
    type: uint32-array
  allwinner,phy:
    type: phandle
  allwinner,drive-level:
    type: uint32
  pinctrl-names:
    type: string
  pinctrl-0:
    type: phandle
  status:
    type: string
    enum: [okay, disabled]

required:
  - compatible
  - reg
  - allwinner,variant
  - allwinner,clock-gate
  - allwinner,reset

dt2c,device: true
```

## dts/bindings/display/allwinner,sunxi-panel.yaml
```yaml
$schema: http://devicetree.org/meta-schemas/core.yaml#
title: Display panel timing, bus format and command sequences used by SyterKit

properties:
  compatible:
    const: allwinner,sunxi-panel
  clock-frequency:
    type: uint32
  hactive:
    type: uint32
  vactive:
    type: uint32
  hfront-porch:
    type: uint32
  hback-porch:
    type: uint32
  hsync-len:
    type: uint32
  vfront-porch:
    type: uint32
  vback-porch:
    type: uint32
  vsync-len:
    type: uint32
  hsync-active:
    type: uint32
  vsync-active:
    type: uint32
  de-active:
    type: uint32
  pixelclk-active:
    type: uint32
  allwinner,bus-format:
    type: string
    enum: [rgb888, rgb666, rgb565]
  allwinner,dsi-lanes:
    type: uint32
  allwinner,dsi-channel:
    type: uint32
  allwinner,dsi-format:
    type: string
    enum: [rgb888, rgb666, rgb666-packed, rgb565]
  allwinner,dsi-mode-flags:
    type: uint32
  enable-delay-ms:
    type: uint32
  width-mm:
    type: uint32
  height-mm:
    type: uint32
  allwinner,gpio-controller:
    type: phandle
  power-on-sequence:
    type: uint32-array
  power-off-sequence:
    type: uint32-array
  init-sequence:
    type: uint32-array
  exit-sequence:
    type: uint32-array
  status:
    type: string
    enum: [okay, disabled]

required:
  - compatible
  - clock-frequency
  - hactive
  - vactive
  - hsync-len
  - vsync-len

dt2c,device: true
```

## dts/bindings/display/allwinner,sunxi-rgb.yaml
```yaml
$schema: http://devicetree.org/meta-schemas/core.yaml#
title: Allwinner parallel RGB (HV) output of the TCON used by SyterKit

properties:
  compatible:
    const: allwinner,sunxi-rgb
  allwinner,hv-mode:
    type: uint32
  allwinner,srgb-seq:
    type: uint32
  allwinner,syuv-seq:
    type: uint32
  allwinner,syuv-fdly:
    type: uint32
  allwinner,rgb-swap:
    type: uint32
  allwinner,rb-swap:
    type: uint32
  allwinner,clk-phase:
    type: uint32
  allwinner,io-adjust:
    type: uint32
  allwinner,drive-level:
    type: uint32
  pinctrl-names:
    type: string
  pinctrl-0:
    type: phandle
  status:
    type: string
    enum: [okay, disabled]

required:
  - compatible
  - pinctrl-names
  - pinctrl-0

dt2c,device: true
```

## dts/bindings/display/allwinner,sunxi-tcon-lcd.yaml
```yaml
$schema: http://devicetree.org/meta-schemas/core.yaml#
title: Allwinner TCON LCD timing controller used by SyterKit

properties:
  compatible:
    const: allwinner,sunxi-tcon-lcd
  reg:
    type: reg
  allwinner,variant:
    type: string
  allwinner,clock-gate:
    type: uint32-array
  allwinner,reset:
    type: uint32-array
  allwinner,module-clock:
    type: uint32-array
  allwinner,tcon-id:
    type: uint32
  status:
    type: string
    enum: [okay, disabled]

required:
  - compatible
  - reg
  - allwinner,variant
  - allwinner,clock-gate
  - allwinner,reset
  - allwinner,module-clock

dt2c,device: true
```
