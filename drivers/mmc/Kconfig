## drivers/mmc/Kconfig
```kconfig
# SPDX-License-Identifier: GPL-2.0+

menu "MMC driver"

config DRIVER_MMC
	bool "MMC controller support"

config DRIVER_MMC_TUNING
	bool "eMMC HS200/HS400 tuning"
	depends on DRIVER_MMC
	help
	  Enable eMMC HS200 and HS400 mode selection and sampling-point tuning.
	  Tuning allocates a roughly 6 KiB (4-bit) or 10 KiB (8-bit) workspace,
	  so initialize the heap before probing the eMMC. Leave it disabled when
	  only legacy, HS or DDR52 operation is required.

config DRIVER_MMC_SHOW_TRAINING
	bool "Show MMC sampling training chart"
	depends on DRIVER_MMC_TUNING
	help
	  Print the MMC sampling training result as a delay-by-pass chart.
	  Disable this option to remove the chart buffers and debug logging code.

choice
	prompt "MMC driver log level"
	default DRIVER_MMC_LOG_TRACE if BUILD_TRACE
	default DRIVER_MMC_LOG_DEBUG if BUILD_DEBUG
	default DRIVER_MMC_LOG_GLOBAL
	depends on DRIVER_MMC

config DRIVER_MMC_LOG_GLOBAL
	bool "Inherit global log level"

config DRIVER_MMC_LOG_MUTE
	bool "Mute"

config DRIVER_MMC_LOG_ERROR
	bool "Error"

config DRIVER_MMC_LOG_WARNING
	bool "Warning"

config DRIVER_MMC_LOG_INFO
	bool "Info"

config DRIVER_MMC_LOG_DEBUG
	bool "Debug"

config DRIVER_MMC_LOG_TRACE
	bool "Trace"

config DRIVER_MMC_LOG_BACKTRACE
	bool "Backtrace"

endchoice

source "drivers/mmc/host/Kconfig"

endmenu
```

## drivers/mtd/Kconfig
```kconfig
# SPDX-License-Identifier: GPL-2.0+

menu "MTD driver"

config DRIVER_MTD
	bool "Memory technology device support"

choice
	prompt "MTD driver log level"
	default DRIVER_MTD_LOG_TRACE if BUILD_TRACE
	default DRIVER_MTD_LOG_DEBUG if BUILD_DEBUG
	default DRIVER_MTD_LOG_GLOBAL
	depends on DRIVER_MTD

config DRIVER_MTD_LOG_GLOBAL
	bool "Inherit global log level"

config DRIVER_MTD_LOG_MUTE
	bool "Mute"

config DRIVER_MTD_LOG_ERROR
	bool "Error"

config DRIVER_MTD_LOG_WARNING
	bool "Warning"

config DRIVER_MTD_LOG_INFO
	bool "Info"

config DRIVER_MTD_LOG_DEBUG
	bool "Debug"

config DRIVER_MTD_LOG_TRACE
	bool "Trace"

config DRIVER_MTD_LOG_BACKTRACE
	bool "Backtrace"

endchoice

choice DRIVER_MTD_FLASH_BACKEND
	prompt "MTD flash driver"
	default DRIVER_MTD_SPI_NOR if DRIVER_SPI
	default DRIVER_MTD_SPIF_NOR if DRIVER_SPIF
	depends on DRIVER_MTD

config DRIVER_MTD_SPI_NOR
	bool "SPI NOR (standard SPI controller)"
	depends on DRIVER_SPI

config DRIVER_MTD_SPIF_NOR
	bool "SPI NOR (SPIF controller)"
	depends on DRIVER_SPIF

config DRIVER_MTD_SPI_NAND
	bool "SPI NAND"
	depends on DRIVER_SPI

endchoice

source "drivers/mtd/nand/Kconfig"
source "drivers/mtd/spi-nor/Kconfig"
source "drivers/mtd/spif-nor/Kconfig"

endmenu
```

## drivers/mtd/spif-nor/Kconfig
```kconfig
# SPDX-License-Identifier: GPL-2.0+

config DRIVER_MTD_SPIF_NOR_SHOW_TRAINING
	bool "Show sampling training chart"
	depends on DRIVER_MTD_SPIF_NOR
	help
	  Print the SPIF NOR sampling training result as a mode-by-delay chart.
	  Disable this option to remove the chart buffers and logging code.

config DRIVER_MTD_SPIF_NOR_SAVE_PARAMS
	bool "Keep the sampling point in a parameter area of the flash"
	depends on DRIVER_MTD_SPIF_NOR
	default y
	help
	  The sampling training of the SPIF controller takes about 0.6 s at every start. With this
	  option an application that sets spif_nor_t.params_offset keeps the result in a 64 KiB area
	  of the flash: a later start reads it at low speed, checks it against the data of the area
	  and goes on without the training. The training, when it runs, works in that area and not
	  at the start of the flash where the boot code is. Without the option, or without an offset,
	  the training runs at every start at the beginning of the flash.

config DRIVER_MTD_SPIF_NOR_PARAMS_OFFSET
	hex "Flash offset of the parameter area (64 KiB aligned)"
	depends on DRIVER_MTD_SPIF_NOR_SAVE_PARAMS
	default 0x20000
	help
	  Used by the applications that keep the sampling point (xip-boot). 128 KiB leaves room for the
	  boot code in front of it.

config DRIVER_MTD_SPIF_NOR_XIP_OFFSET
	hex "Flash offset of the image run in place (xip-boot)"
	depends on DRIVER_MTD_SPIF_NOR
	default 0x80000
	help
	  The image that xip-boot maps at the window of the controller starts here (4 KiB aligned).
```

## drivers/pcie/Kconfig
```kconfig
# SPDX-License-Identifier: GPL-2.0+

menu "PCIe driver"

config DRIVER_PCIE
	bool "PCIe controller support"
	depends on SOC_SUN55IW6
	help
	  Enable the layered PCIe controller driver for the sun55iw6.
	  The DesignWare controller and INNO PHY are initialized only when
	  board code calls the RC or EP entry point.

config DRIVER_PCIE_RC
	bool "PCIe root complex support"
	depends on DRIVER_PCIE
	default y
	help
	  Provide root-complex setup, link training and configuration-space access.

config DRIVER_PCIE_EP
	bool "PCIe endpoint support"
	depends on DRIVER_PCIE
	default y
	help
	  Provide endpoint header, BAR, iATU, MSI and LTSSM operations.

choice
	prompt "PCIe driver log level"
	default DRIVER_PCIE_LOG_TRACE if BUILD_TRACE
	default DRIVER_PCIE_LOG_DEBUG if BUILD_DEBUG
	default DRIVER_PCIE_LOG_GLOBAL
	depends on DRIVER_PCIE

config DRIVER_PCIE_LOG_GLOBAL
	bool "Inherit global log level"

config DRIVER_PCIE_LOG_MUTE
	bool "Mute"

config DRIVER_PCIE_LOG_ERROR
	bool "Error"

config DRIVER_PCIE_LOG_WARNING
	bool "Warning"

config DRIVER_PCIE_LOG_INFO
	bool "Info"

config DRIVER_PCIE_LOG_DEBUG
	bool "Debug"

config DRIVER_PCIE_LOG_TRACE
	bool "Trace"

config DRIVER_PCIE_LOG_BACKTRACE
	bool "Backtrace"

endchoice

endmenu
```

## drivers/pmu/Kconfig
```kconfig
# SPDX-License-Identifier: GPL-2.0+

menu "PMU driver"

config DRIVER_PMIC_AXP
	bool "AXP PMIC support"

choice
	prompt "PMU driver log level"
	default DRIVER_PMU_LOG_TRACE if BUILD_TRACE
	default DRIVER_PMU_LOG_DEBUG if BUILD_DEBUG
	default DRIVER_PMU_LOG_GLOBAL
	depends on DRIVER_PMIC_AXP

config DRIVER_PMU_LOG_GLOBAL
	bool "Inherit global log level"

config DRIVER_PMU_LOG_MUTE
	bool "Mute"

config DRIVER_PMU_LOG_ERROR
	bool "Error"

config DRIVER_PMU_LOG_WARNING
	bool "Warning"

config DRIVER_PMU_LOG_INFO
	bool "Info"

config DRIVER_PMU_LOG_DEBUG
	bool "Debug"

config DRIVER_PMU_LOG_TRACE
	bool "Trace"

config DRIVER_PMU_LOG_BACKTRACE
	bool "Backtrace"

endchoice

endmenu
```

## drivers/psram/Kconfig
```kconfig
# SPDX-License-Identifier: GPL-2.0+

menu "PSRAM driver"

config DRIVER_PSRAM
	bool "PSRAM controller support"
	help
	  Initialize mapped SPI PSRAM on sun252iw1, or LPSRAM from its
	  parameter block on sun252iw2.

choice
	prompt "PSRAM driver log level"
	default DRIVER_PSRAM_LOG_TRACE if BUILD_TRACE
	default DRIVER_PSRAM_LOG_DEBUG if BUILD_DEBUG
	default DRIVER_PSRAM_LOG_GLOBAL
	depends on DRIVER_PSRAM

config DRIVER_PSRAM_LOG_GLOBAL
	bool "Inherit global log level"

config DRIVER_PSRAM_LOG_MUTE
	bool "Mute"

config DRIVER_PSRAM_LOG_ERROR
	bool "Error"

config DRIVER_PSRAM_LOG_WARNING
	bool "Warning"

config DRIVER_PSRAM_LOG_INFO
	bool "Info"

config DRIVER_PSRAM_LOG_DEBUG
	bool "Debug"

config DRIVER_PSRAM_LOG_TRACE
	bool "Trace"

config DRIVER_PSRAM_LOG_BACKTRACE
	bool "Backtrace"

endchoice

endmenu
```

## drivers/pwm/Kconfig
```kconfig
# SPDX-License-Identifier: GPL-2.0+

menu "PWM driver"

config DRIVER_PWM
	bool "PWM controller support"

choice
	prompt "PWM driver log level"
	default DRIVER_PWM_LOG_TRACE if BUILD_TRACE
	default DRIVER_PWM_LOG_DEBUG if BUILD_DEBUG
	default DRIVER_PWM_LOG_GLOBAL
	depends on DRIVER_PWM

config DRIVER_PWM_LOG_GLOBAL
	bool "Inherit global log level"

config DRIVER_PWM_LOG_MUTE
	bool "Mute"

config DRIVER_PWM_LOG_ERROR
	bool "Error"

config DRIVER_PWM_LOG_WARNING
	bool "Warning"

config DRIVER_PWM_LOG_INFO
	bool "Info"

config DRIVER_PWM_LOG_DEBUG
	bool "Debug"

config DRIVER_PWM_LOG_TRACE
	bool "Trace"

config DRIVER_PWM_LOG_BACKTRACE
	bool "Backtrace"

endchoice

endmenu
```

## drivers/remoteproc/Kconfig
```kconfig
# SPDX-License-Identifier: GPL-2.0+

menu "Remote processor driver"

config DRIVER_REMOTEPROC
	bool "Remote processor support"

config DRIVER_REMOTEPROC_SUN8IW20_C906
	bool "Use C906 remote processor on Sun8iW20"
	depends on DRIVER_REMOTEPROC && SOC_SUN8IW20

choice
	prompt "Remote processor driver log level"
	default DRIVER_REMOTEPROC_LOG_TRACE if BUILD_TRACE
	default DRIVER_REMOTEPROC_LOG_DEBUG if BUILD_DEBUG
	default DRIVER_REMOTEPROC_LOG_GLOBAL
	depends on DRIVER_REMOTEPROC

config DRIVER_REMOTEPROC_LOG_GLOBAL
	bool "Inherit global log level"

config DRIVER_REMOTEPROC_LOG_MUTE
	bool "Mute"

config DRIVER_REMOTEPROC_LOG_ERROR
	bool "Error"

config DRIVER_REMOTEPROC_LOG_WARNING
	bool "Warning"

config DRIVER_REMOTEPROC_LOG_INFO
	bool "Info"

config DRIVER_REMOTEPROC_LOG_DEBUG
	bool "Debug"

config DRIVER_REMOTEPROC_LOG_TRACE
	bool "Trace"

config DRIVER_REMOTEPROC_LOG_BACKTRACE
	bool "Backtrace"

endchoice

endmenu
```

## drivers/rng/Kconfig
```kconfig
# SPDX-License-Identifier: GPL-2.0+

config DRIVER_HW_RANDOM
	bool "Hardware random number generator support"
```

## drivers/rtc/Kconfig
```kconfig
# SPDX-License-Identifier: GPL-2.0+

menu "RTC driver"

config DRIVER_RTC
	bool "Real-time clock support"

choice
	prompt "RTC driver log level"
	default DRIVER_RTC_LOG_TRACE if BUILD_TRACE
	default DRIVER_RTC_LOG_DEBUG if BUILD_DEBUG
	default DRIVER_RTC_LOG_GLOBAL
	depends on DRIVER_RTC

config DRIVER_RTC_LOG_GLOBAL
	bool "Inherit global log level"

config DRIVER_RTC_LOG_MUTE
	bool "Mute"

config DRIVER_RTC_LOG_ERROR
	bool "Error"

config DRIVER_RTC_LOG_WARNING
	bool "Warning"

config DRIVER_RTC_LOG_INFO
	bool "Info"

config DRIVER_RTC_LOG_DEBUG
	bool "Debug"

config DRIVER_RTC_LOG_TRACE
	bool "Trace"

config DRIVER_RTC_LOG_BACKTRACE
	bool "Backtrace"

endchoice

endmenu
```

## drivers/sdhci/Kconfig
```kconfig
# SPDX-License-Identifier: GPL-2.0+

config DRIVER_SDHCI
	bool "SD host controller interface support"
```

## drivers/serial/Kconfig
```kconfig
# SPDX-License-Identifier: GPL-2.0+

menu "Serial driver"

config DRIVER_SERIAL
	bool "Serial driver support"

choice
	prompt "Serial driver log level"
	default DRIVER_SERIAL_LOG_TRACE if BUILD_TRACE
	default DRIVER_SERIAL_LOG_DEBUG if BUILD_DEBUG
	default DRIVER_SERIAL_LOG_GLOBAL
	depends on DRIVER_SERIAL

config DRIVER_SERIAL_LOG_GLOBAL
	bool "Inherit global log level"

config DRIVER_SERIAL_LOG_MUTE
	bool "Mute"

config DRIVER_SERIAL_LOG_ERROR
	bool "Error"

config DRIVER_SERIAL_LOG_WARNING
	bool "Warning"

config DRIVER_SERIAL_LOG_INFO
	bool "Info"

config DRIVER_SERIAL_LOG_DEBUG
	bool "Debug"

config DRIVER_SERIAL_LOG_TRACE
	bool "Trace"

config DRIVER_SERIAL_LOG_BACKTRACE
	bool "Backtrace"

endchoice

endmenu
```

## drivers/sid/Kconfig
```kconfig
# SPDX-License-Identifier: GPL-2.0+

menu "SID driver"

config DRIVER_SID
	bool "Security ID controller support"

choice
	prompt "SID driver log level"
	default DRIVER_SID_LOG_TRACE if BUILD_TRACE
	default DRIVER_SID_LOG_DEBUG if BUILD_DEBUG
	default DRIVER_SID_LOG_GLOBAL
	depends on DRIVER_SID

config DRIVER_SID_LOG_GLOBAL
	bool "Inherit global log level"

config DRIVER_SID_LOG_MUTE
	bool "Mute"

config DRIVER_SID_LOG_ERROR
	bool "Error"

config DRIVER_SID_LOG_WARNING
	bool "Warning"

config DRIVER_SID_LOG_INFO
	bool "Info"

config DRIVER_SID_LOG_DEBUG
	bool "Debug"

config DRIVER_SID_LOG_TRACE
	bool "Trace"

config DRIVER_SID_LOG_BACKTRACE
	bool "Backtrace"

endchoice

endmenu
```

## drivers/soc/Kconfig
```kconfig
# SPDX-License-Identifier: GPL-2.0+

menu "SoC driver"

config DRIVER_SOC
	bool "Allwinner SoC identification support"

choice
	prompt "SoC driver log level"
	default DRIVER_SOC_LOG_TRACE if BUILD_TRACE
	default DRIVER_SOC_LOG_DEBUG if BUILD_DEBUG
	default DRIVER_SOC_LOG_GLOBAL
	depends on DRIVER_SOC

config DRIVER_SOC_LOG_GLOBAL
	bool "Inherit global log level"

config DRIVER_SOC_LOG_MUTE
	bool "Mute"

config DRIVER_SOC_LOG_ERROR
	bool "Error"

config DRIVER_SOC_LOG_WARNING
	bool "Warning"

config DRIVER_SOC_LOG_INFO
	bool "Info"

config DRIVER_SOC_LOG_DEBUG
	bool "Debug"

config DRIVER_SOC_LOG_TRACE
	bool "Trace"

config DRIVER_SOC_LOG_BACKTRACE
	bool "Backtrace"

endchoice

endmenu
```

## drivers/spi/Kconfig
```kconfig
# SPDX-License-Identifier: GPL-2.0+

menu "SPI driver"

config DRIVER_SPI
	bool "SPI controller support"

choice
	prompt "SPI driver log level"
	default DRIVER_SPI_LOG_TRACE if BUILD_TRACE
	default DRIVER_SPI_LOG_DEBUG if BUILD_DEBUG
	default DRIVER_SPI_LOG_GLOBAL
	depends on DRIVER_SPI

config DRIVER_SPI_LOG_GLOBAL
	bool "Inherit global log level"

config DRIVER_SPI_LOG_MUTE
	bool "Mute"

config DRIVER_SPI_LOG_ERROR
	bool "Error"

config DRIVER_SPI_LOG_WARNING
	bool "Warning"

config DRIVER_SPI_LOG_INFO
	bool "Info"

config DRIVER_SPI_LOG_DEBUG
	bool "Debug"

config DRIVER_SPI_LOG_TRACE
	bool "Trace"

config DRIVER_SPI_LOG_BACKTRACE
	bool "Backtrace"

endchoice

endmenu
```

## drivers/spif/Kconfig
```kconfig
# SPDX-License-Identifier: GPL-2.0+

menu "SPIF driver"

config DRIVER_SPIF
	bool "SPIF controller support"
	default n
	help
	  Enable the Allwinner SPIF controller used by SPI NOR/NAND boot flash.
	  The controller is configured from an allwinner,sunxi-spif device-tree
	  node and owns the SPI memory operation interface internally.

source "drivers/spif/platform/Kconfig"

endmenu
```

## drivers/spif/platform/Kconfig
```kconfig
# SPDX-License-Identifier: GPL-2.0+

choice
	prompt "SPIF controller hardware version"
	default DRIVER_SPIF_V1
	depends on DRIVER_SPIF

config DRIVER_SPIF_V0
	bool "SPIF V0"
	help
	  Select the legacy SPIF descriptor and transfer layout.

config DRIVER_SPIF_V1
	bool "SPIF V1"
	help
	  Select the SPIF V1 descriptor and transfer layout.

config DRIVER_SPIF_V2
	bool "SPIF V2"
	help
	  Select the SPIF V2 descriptor layout with one- and two-byte addresses.

endchoice
```
