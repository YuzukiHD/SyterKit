## dts/bindings/display/allwinner,sunxi-tcon-top.yaml
```yaml
$schema: http://devicetree.org/meta-schemas/core.yaml#
title: Allwinner TCON top (display interface top) used by SyterKit

properties:
  compatible:
    const: allwinner,sunxi-tcon-top
  reg:
    type: reg
  allwinner,variant:
    type: string
  allwinner,clock-gate:
    type: uint32-array
  allwinner,reset:
    type: uint32-array
  status:
    type: string
    enum: [okay, disabled]

required:
  - compatible
  - reg
  - allwinner,variant
  - allwinner,clock-gate
  - allwinner,reset

dt2c,device: true
```

## dts/bindings/dma/allwinner,sunxi-dma.yaml
```yaml
$schema: http://devicetree.org/meta-schemas/core.yaml#
title: Allwinner DMA controller used by SyterKit

properties:
  compatible:
    const: allwinner,sunxi-dma
  reg:
    type: reg
  "#dma-cells":
    type: uint32
  allwinner,mbus-clock-gate:
    type: uint32-array
  allwinner,clock-gate:
    type: uint32-array
  allwinner,reset:
    type: uint32-array
  status:
    type: string
    enum: [okay, disabled]

required:
  - compatible
  - reg
  - "#dma-cells"
  - allwinner,mbus-clock-gate
  - allwinner,clock-gate
  - allwinner,reset

dt2c,device: true
```

## dts/bindings/gpio/allwinner,sunxi-pinctrl.yaml
```yaml
$schema: http://devicetree.org/meta-schemas/core.yaml#
title: Allwinner pin controller used by SyterKit

properties:
  compatible:
    const: allwinner,sunxi-pinctrl
  reg:
    type: reg
  "#gpio-cells":
    type: uint32
  gpio-controller:
    type: boolean
  allwinner,bank-base:
    type: uint32
  allwinner,bank-count:
    type: uint32
  status:
    type: string
    enum: [okay, disabled]

required:
  - compatible
  - reg
  - "#gpio-cells"
  - gpio-controller
  - allwinner,bank-base
  - allwinner,bank-count

dt2c,device: true
```

## dts/bindings/i2c/allwinner,sunxi-i2c.yaml
```yaml
$schema: http://devicetree.org/meta-schemas/core.yaml#
title: Allwinner I2C controller used by SyterKit

properties:
  compatible:
    const: allwinner,sunxi-i2c
  reg:
    type: reg
  clock-frequency:
    type: uint32
  allwinner,i2c-id:
    type: uint32
  allwinner,parent-clock-frequency:
    type: uint32
  allwinner,clock-gate:
    type: uint32-array
  allwinner,reset:
    type: uint32-array
  pinctrl-names:
    type: string
  pinctrl-0:
    type: phandle
  status:
    type: string
    enum: [okay, disabled]

required:
  - compatible
  - reg
  - clock-frequency
  - allwinner,i2c-id
  - allwinner,parent-clock-frequency
  - allwinner,clock-gate
  - allwinner,reset
  - pinctrl-names
  - pinctrl-0
dt2c,device: true
```

## dts/bindings/interrupt-controller/allwinner,sunxi-plic.yaml
```yaml
$schema: http://devicetree.org/meta-schemas/core.yaml#
title: Allwinner RISC-V platform-level interrupt controller used by SyterKit

properties:
  compatible:
    const: allwinner,sunxi-plic
  reg:
    type: reg
  interrupt-controller:
    type: boolean
  "#interrupt-cells":
    type: uint32
  riscv,num-sources:
    type: uint32
  status:
    type: string
    enum: [okay, disabled]

required:
  - compatible
  - reg
  - interrupt-controller
  - "#interrupt-cells"
  - riscv,num-sources

dt2c,device: true
```

## dts/bindings/interrupt-controller/arm,gic-400.yaml
```yaml
$schema: http://devicetree.org/meta-schemas/core.yaml#
title: ARM Generic Interrupt Controller v2 used by SyterKit

properties:
  compatible:
    const: arm,gic-400
  reg:
    type: reg
  interrupt-controller:
    type: boolean
  "#interrupt-cells":
    type: uint32
  allwinner,irq-count:
    type: uint32
  status:
    type: string
    enum: [okay, disabled]

required:
  - compatible
  - reg
  - interrupt-controller
  - "#interrupt-cells"
  - allwinner,irq-count

dt2c,device: true
```

## dts/bindings/interrupt-controller/thead,c900-clic.yaml
```yaml
$schema: http://devicetree.org/meta-schemas/core.yaml#
title: T-Head C900 Core-Local Interrupt Controller used by SyterKit

properties:
  compatible:
    const: thead,c900-clic
  reg:
    type: reg
  interrupt-controller:
    type: boolean
  "#interrupt-cells":
    type: uint32
  riscv,num-sources:
    type: uint32
  status:
    type: string
    enum: [okay, disabled]

required:
  - compatible
  - reg
  - interrupt-controller
  - "#interrupt-cells"
  - riscv,num-sources

dt2c,device: true
```

## dts/bindings/memory/allwinner,sun252iw1-sqpi-psram.yaml
```yaml
# SPDX-License-Identifier: MIT
$schema: http://devicetree.org/meta-schemas/core.yaml#
title: Allwinner sun252iw1 SQPI PSRAM controller

description: |
  SPI PSRAM with 24-bit addresses and 1-4-4 mapped reads and writes.
  reg contains the controller registers followed by the CPU memory window.
  The module clock tuple is register address, source selection, parent rate
  in Hz. Source 0 is HOSC (24 MHz), 1/2/3 is PERI 480/400/300 MHz; the caller
  must make a selected PLL parent available before initialization.
  Pin order is CS, CLK, IO0, IO1, IO2, IO3. Capacity is expressed in bytes
  and checked against the device ID. Supported densities are 2/4/8 MiB.

properties:
  compatible:
    const: allwinner,sun252iw1-sqpi-psram
  reg:
    type: reg
  allwinner,module-clock:
    type: uint32-array
  allwinner,clock-gate:
    type: uint32-array
  allwinner,reset:
    type: uint32-array
  clock-frequency:
    type: uint32
  allwinner,capacity:
    type: uint32
  pinctrl-names:
    type: string
  pinctrl-0:
    type: phandle
  status:
    type: string
    enum: [okay, disabled]

required:
  - compatible
  - reg
  - allwinner,module-clock
  - allwinner,clock-gate
  - allwinner,reset
  - clock-frequency
  - allwinner,capacity
  - pinctrl-names
  - pinctrl-0

dt2c,device: true
```

## dts/bindings/memory/allwinner,sunxi-dram.yaml
```yaml
$schema: http://devicetree.org/meta-schemas/core.yaml#
title: Allwinner DRAM parameters used by SyterKit

properties:
  compatible:
    const: allwinner,sunxi-dram
  allwinner,dram-parameters:
    type: uint32-array
  status:
    type: string
    enum: [okay, disabled]

required:
  - compatible
  - allwinner,dram-parameters

dt2c,device: true
```

## dts/bindings/mmc/allwinner,sunxi-mmc.yaml
```yaml
$schema: http://devicetree.org/meta-schemas/core.yaml#
title: Allwinner MMC host controller used by SyterKit

properties:
  compatible:
    const: allwinner,sunxi-mmc
  reg:
    type: reg
  label:
    type: string
  allwinner,mmc-id:
    type: uint32
  bus-width:
    type: uint32
    enum: [1, 4, 8]
  max-frequency:
    type: uint32
  non-removable:
    type: boolean
  allwinner,io-1v8:
    type: boolean
    description: The MMC I/O rail is fixed at 1.8 V and needs no runtime switch.
  memory-region:
    type: phandle
  allwinner,clock-gate:
    type: uint32-array
  allwinner,reset:
    type: uint32-array
  allwinner,module-clock:
    type: uint32-array
    description: Module clock register, N offset, M offset, and default mux source
  allwinner,clock-source-rates:
    type: uint32-array
    description: Clock rates in Hz for mux sources 0 through 3; zero marks an unsupported source
  pinctrl-names:
    type: string
  pinctrl-0:
    type: phandle
  allwinner,card-detect:
    type: phandle-array
  status:
    type: string
    enum: [okay, disabled]

required:
  - compatible
  - reg
  - allwinner,mmc-id
  - bus-width
  - max-frequency
  - memory-region
  - allwinner,clock-gate
  - allwinner,reset
  - allwinner,module-clock
  - allwinner,clock-source-rates
  - pinctrl-names
  - pinctrl-0

dt2c,device: true
```

## dts/bindings/mtd/jedec,spi-nor.yaml
```yaml
$schema: http://devicetree.org/meta-schemas/core.yaml#
title: JEDEC SPI NOR flash used by SyterKit

properties:
  compatible:
    const: jedec,spi-nor
  reg:
    type: uint32-array
  spi-max-frequency:
    type: uint32
  status:
    type: string
    enum: [okay, disabled]

required:
  - compatible
  - reg
  - spi-max-frequency

dt2c,device: true
```

## dts/bindings/mtd/spi-nand.yaml
```yaml
$schema: http://devicetree.org/meta-schemas/core.yaml#
title: SPI NAND flash used by SyterKit

properties:
  compatible:
    const: spi-nand
  reg:
    type: uint32-array
  spi-max-frequency:
    type: uint32
  status:
    type: string
    enum: [okay, disabled]

required:
  - compatible
  - reg
  - spi-max-frequency

dt2c,device: true
```

## dts/bindings/pcie/allwinner,sun55iw6-pcie.yaml
```yaml
# SPDX-License-Identifier: GPL-2.0+

%YAML 1.2
---
$id: http://devicetree.org/schemas/pcie/allwinner,sun55iw6-pcie.yaml#
$schema: http://devicetree.org/meta-schemas/core.yaml#

title: Allwinner sun55iw6 PCIe controller

maintainers:
  - SyterKit maintainers

properties:
  compatible:
    enum:
      - allwinner,sun55iw6-pcie-rc
      - allwinner,sun55iw6-pcie-ep

  reg:
    maxItems: 1
    description: DesignWare DBI register space

  allwinner,app-base:
    type: uint32
    description: Optional application register base, defaults to DBI + 0x400000

  allwinner,phy-subsys-base:
    type: uint32
    description: SerDes subsystem application register base

  allwinner,phy-base:
    type: uint32
    description: INNO PCIe PHY register base

  allwinner,config-window:
    type: uint32-array
    minItems: 3
    maxItems: 3
    description: CPU address, PCI address metadata and size of the configuration window; the controller encodes the BDF as the iATU target

  allwinner,io-window:
    type: uint32-array
    minItems: 3
    maxItems: 3
    description: CPU address, PCI address and size of the I/O window

  allwinner,mem-window:
    type: uint32-array
    minItems: 3
    maxItems: 3
    description: CPU address, PCI address and size of the memory window

  num-lanes:
    type: uint32
    enum: [1]
    default: 1

  max-link-speed:
    type: uint32
    enum: [1, 2]
    default: 2

  allwinner,timeout-us:
    type: uint32
    default: 1000000

  reset-gpios:
    type: phandle-array
    minItems: 1
    maxItems: 1
    description: Optional external endpoint reset GPIO in SyterKit GPIO format

  status:
    type: string
    enum: [okay, disabled]

required:
  - compatible
  - reg

additionalProperties: true

dt2c,device: true
```

## dts/bindings/pmic/x-powers,axp-pmu.yaml
```yaml
$schema: http://devicetree.org/meta-schemas/core.yaml#
title: X-Powers AXP PMIC used by SyterKit

properties:
  compatible:
    type: string
    enum:
      - x-powers,axp1530
      - x-powers,axp2101
      - x-powers,axp2202
      - x-powers,axp333
      - x-powers,axp8191
  reg:
    type: uint32-array
  status:
    type: string
    enum: [okay, disabled]

required:
  - compatible
  - reg

dt2c,device: true
```

## dts/bindings/pwm/allwinner,sunxi-pwm.yaml
```yaml
$schema: http://devicetree.org/meta-schemas/core.yaml#
title: Allwinner PWM controller used by SyterKit

properties:
  compatible:
    const: allwinner,sunxi-pwm
  reg:
    type: reg
  "#pwm-cells":
    type: uint32
  allwinner,pwm-id:
    type: uint32
  clock-frequency:
    type: uint32
  allwinner,apb-clock-frequency:
    type: uint32
  allwinner,clock-gate:
    type: uint32-array
  allwinner,reset:
    type: uint32-array
  allwinner,channel-config:
    type: uint32-array
  pinctrl-names:
    type: string
  pinctrl-0:
    type: phandle
  status:
    type: string
    enum: [okay, disabled]

required:
  - compatible
  - reg
  - "#pwm-cells"
  - allwinner,pwm-id
  - clock-frequency
  - allwinner,apb-clock-frequency
  - allwinner,clock-gate
  - allwinner,reset
  - allwinner,channel-config
  - pinctrl-names
  - pinctrl-0

dt2c,device: true
```

## dts/bindings/remoteproc/allwinner,sunxi-remoteproc.yaml
```yaml
$schema: http://devicetree.org/meta-schemas/core.yaml#
title: Allwinner remote processors used by SyterKit

properties:
  compatible:
    type: string
    enum:
      - allwinner,sun20iw1-hifi4
      - allwinner,sun300iw1-a27l2
      - allwinner,sun50iw10-ar100
      - allwinner,sun55iw3-e906
      - allwinner,sun8iw20-c906
      - allwinner,sun8iw20-hifi4
      - allwinner,sun8iw21-e907
  reg:
    type: reg
  firmware-name:
    type: string
  memory-region:
    type: phandle
  allwinner,firmware-format:
    type: string
    enum: [elf32, elf64, raw]
  allwinner,entry-address:
    type: uint32
  allwinner,address-map:
    type: uint32-array
  allwinner,auxiliary-firmware-names:
    type: string-array
  allwinner,auxiliary-memory-regions:
    type: phandle-array
  allwinner,rtc:
    type: phandle
  status:
    type: string
    enum: [okay, disabled]

required:
  - compatible
  - reg
  - firmware-name
  - memory-region
  - allwinner,firmware-format
dt2c,device: true
```

## dts/bindings/rtc/allwinner,sunxi-rtc.yaml
```yaml
$schema: http://devicetree.org/meta-schemas/core.yaml#
title: Allwinner RTC scratch registers used by SyterKit

properties:
  compatible:
    const: allwinner,sunxi-rtc
  reg:
    type: reg
  status:
    type: string
    enum: [okay, disabled]

required:
  - compatible
  - reg

dt2c,device: true
```

## dts/bindings/serial/allwinner,sunxi-uart.yaml
```yaml
$schema: http://devicetree.org/meta-schemas/core.yaml#
title: Allwinner UART used by SyterKit

properties:
  compatible:
    const: allwinner,sunxi-uart
  reg:
    type: reg
  current-speed:
    type: uint32
  clock-frequency:
    type: uint32
  allwinner,uart-id:
    type: uint32
  allwinner,clock-gate:
    type: uint32-array
  allwinner,reset:
    type: uint32-array
  pinctrl-names:
    type: string
  pinctrl-0:
    type: phandle
  data-bits:
    type: uint32
    default: 8
  stop-bits:
    type: uint32
    default: 1
  parity:
    type: string
    default: none
    enum: [none, odd, even]
  status:
    type: string
    enum: [okay, disabled]

required:
  - compatible
  - reg
  - current-speed
  - clock-frequency
  - allwinner,uart-id
  - allwinner,clock-gate
  - allwinner,reset
  - pinctrl-names
  - pinctrl-0

dt2c,device: true
```

## dts/bindings/soc/allwinner,soc.yaml
```yaml
$schema: http://devicetree.org/meta-schemas/core.yaml#
title: Allwinner SoC identification registers used by SyterKit

properties:
  compatible:
    const: allwinner,soc
  reg:
    type: reg
  status:
    type: string
    enum: [okay, disabled]

required:
  - compatible
  - reg

dt2c,device: true
```

## dts/bindings/soc/allwinner,sunxi-sid.yaml
```yaml
$schema: http://devicetree.org/meta-schemas/core.yaml#
title: Allwinner Security ID controller used by SyterKit

properties:
  compatible:
    const: allwinner,sunxi-sid
  reg:
    type: reg
  allwinner,efuse-hv-switch:
    type: uint32
    description: Optional high-voltage switch register used for eFuse writes
  allwinner,sid-sram-base:
    type: uint32
    description: Optional base address of the eFuse SRAM mirror
  status:
    type: string
    enum: [okay, disabled]

required:
  - compatible
  - reg

dt2c,device: true
```

## dts/bindings/spi/allwinner,sunxi-spi.yaml
```yaml
$schema: http://devicetree.org/meta-schemas/core.yaml#
title: Allwinner SPI controller used by SyterKit

properties:
  compatible:
    const: allwinner,sunxi-spi
  allwinner,spi-id:
    type: uint32
  reg:
    type: reg
  clock-frequency:
    type: uint32
  allwinner,module-clock:
    type: uint32-array
  allwinner,clock-gate:
    type: uint32-array
  allwinner,reset:
    type: uint32-array
  dmas:
    type: phandle-array
  dma-names:
    type: string
  allwinner,lcd-dc-gpio:
    type: phandle-array
  allwinner,lcd-reset-gpio:
    type: phandle-array
  allwinner,lcd-backlight-gpio:
    type: phandle-array
  pinctrl-names:
    type: string
  pinctrl-0:
    type: phandle
  status:
    type: string
    enum: [okay, disabled]

required:
  - compatible
  - allwinner,spi-id
  - reg
  - clock-frequency
  - allwinner,module-clock
  - allwinner,clock-gate
  - allwinner,reset
  - pinctrl-names
  - pinctrl-0

dt2c,device: true
```
